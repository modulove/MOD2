/*
HAGIWO MOD2 Retro Game Kick Ver1.1

  • Retro-game-style one-shot kick: triangle body + pulse body + short click
  • 3 potentiometers → Decay / Pitch / Sweep-Morph
  • Trigger input (GPIO 7) : rising edge starts one kick voice
  • PUSH button (GPIO 6) : press edge also starts one kick voice
  • Level input (GPIO 0) : HIGH while playback = output level × 0.5
  • One-shot playback : decay-dependent short kick, approximately 0.13 s to 0.40 s
  • Audio engine intentionally uses expf(), powf(), and tanhf() first; optimize later if needed
  • ADC DMA input + PWM DMA output + Dual Core processing
  • CC0 1.0 — Public-domain. Test thoroughly on your own hardware!

  --Pin assign---
POT1     A0       Kick decay time, 20 ms to 120 ms
POT2     A1       Kick base pitch, 32 Hz to 300 Hz
POT3     A2       Pitch sweep / morph amount, reversed ADC
IN1      GPIO7    Trig in, rising edge starts playback
IN2      GPIO0    Level input, HIGH while playback = output level × 0.5
CV       A2       Shared with POT3
OUT      GPIO1    Audio PWM output (8-bit)
BUTTON   GPIO6    Manual trigger, press edge starts playback
LED      GPIO5    Unused
EEPROM   NA

CC0 1.0 Universal (CC0 1.0) Public Domain Dedication
You can copy, modify, distribute and perform the work, even for commercial purposes, all without asking permission.

Most of the source code was generated by AI.
Although the code has been tested, it may still exhibit unstable behavior or contain incorrect comments.

------------------------------------------------------------------------------
*/

#include <Arduino.h>
#include <math.h>

extern "C" {
  #include "hardware/adc.h"
  #include "hardware/dma.h"
  #include "hardware/pwm.h"
  #include "hardware/irq.h"
  #include "hardware/clocks.h"
  #include "hardware/gpio.h"
  #include "pico/multicore.h"
  #include "pico/critical_section.h"
}

const uint PWM_AUDIO_PIN = 1;

const uint TRIG_IN_PIN = 7;
const uint ACCENT_IN_PIN = 0;
const uint PUSH_BUTTON_PIN = 6;
const uint LED_PIN = 5;

const uint ADC0_GPIO = 26;
const uint ADC1_GPIO = 27;
const uint ADC2_GPIO = 28;

#define ENABLE_DEBUG_PINS 0

#if ENABLE_DEBUG_PINS
const uint CORE1_BUSY_PIN = 8;
const uint UNDERRUN_PIN   = 9;
#endif

const uint32_t SAMPLE_RATE = 48000;
const uint16_t PWM_WRAP = 255;
const uint AUDIO_BLOCK_SIZE = 512;

const float OUTPUT_GAIN = 0.82f;

// PWM DMA alternates these two buffers. Core1 fills the buffer that DMA is not playing.
uint32_t wave_buffer[2][AUDIO_BLOCK_SIZE];

volatile uint8_t dma_playing_buffer = 0;
volatile uint8_t buffer_to_fill = 1;

volatile bool core1_is_busy = false;
volatile bool audio_underrun = false;

// Core0/DMA IRQ increments fill_request_id. Core1 catches up and writes fill_done_id.
volatile uint32_t fill_request_id = 0;
volatile uint32_t fill_done_id = 0;

const uint ADC_CH_COUNT = 3;
const uint ADC_SAMPLES_PER_CH = 16;
const uint ADC_TOTAL_SAMPLES = ADC_CH_COUNT * ADC_SAMPLES_PER_CH;

uint16_t adc_buffer[ADC_TOTAL_SAMPLES];

volatile bool adc_block_ready = false;
volatile uint16_t adc_avg[ADC_CH_COUNT] = {0, 0, 0};

int pwm_dma_chan;
int adc_dma_chan;

uint pwm_slice;
uint pwm_chan;

bool trig_last = LOW;

bool button_last_raw = HIGH;
bool button_stable = HIGH;
bool button_prev_stable = HIGH;
uint32_t button_last_change_ms = 0;

const uint32_t BUTTON_DEBOUNCE_MS = 20;

// One monophonic kick voice. Retrigger simply restarts this state.
struct KickVoice {
  bool active;
  uint32_t sample_index;
  uint32_t duration_samples;
  uint32_t phase;

  float decay;
  float base_pitch;
  float morph;
  float sweep_octaves;
  float duty;
  float drive;
  float click_decay;
  float click_level;
};

struct KickStartRequest {
  uint16_t adc0;
  uint16_t adc1;
  uint16_t adc2;
};

KickVoice voice = {
  false,
  0,
  0,
  0u,
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  0.0045f,
  0.20f
};

// Core0 does not edit voice directly. It stores a request, then Core1 consumes it safely.
KickStartRequest pending_kick = {0, 0, 0};
volatile bool kick_pending = false;

critical_section_t kick_request_crit;

float clampf_local(float x, float lo, float hi) {
  if (x < lo) return lo;
  if (x > hi) return hi;
  return x;
}

float exp_map(uint16_t adc, float low, float high) {
  float norm = adc / 4095.0f;
  return low * powf(high / low, norm);
}

float linear_map(uint16_t adc, float low, float high) {
  float norm = adc / 4095.0f;
  return low + (high - low) * norm;
}

float phase_to_unit(uint32_t phase) {
  return phase * (1.0f / 4294967296.0f);
}

uint32_t make_pwm_cc_value(uint16_t duty) {
  duty &= PWM_WRAP;

  if (pwm_chan == PWM_CHAN_A) {
    return duty;
  } else {
    return ((uint32_t)duty << 16);
  }
}

uint32_t audio_to_pwm_cc(float x) {
  if (x > 1.0f) x = 1.0f;
  if (x < -1.0f) x = -1.0f;

  float y = x * 0.5f + 0.5f;
  uint16_t duty = (uint16_t)(y * PWM_WRAP);

  return make_pwm_cc_value(duty);
}

float osc_triangle(uint32_t phase) {
  float t = phase_to_unit(phase);
  return 2.0f * fabsf(2.0f * t - 1.0f) - 1.0f;
}

float osc_pulse(uint32_t phase, float duty) {
  float t = phase_to_unit(phase);
  return (t < duty) ? 1.0f : -1.0f;
}

float osc_pulse_float_phase(float phase_unit, float duty) {
  float t = phase_unit - floorf(phase_unit);
  return (t < duty) ? 1.0f : -1.0f;
}

bool is_in2_level_half_active() {
  // Read IN2 directly from Core1 audio rendering. HIGH means level x 0.5.
  return gpio_get(ACCENT_IN_PIN);
}

void request_kick() {
  KickStartRequest req;

  // Latch ADC values at trigger timing, so the one-shot sound is stable.
  req.adc0 = adc_avg[0];
  req.adc1 = adc_avg[1];
  req.adc2 = adc_avg[2];

  critical_section_enter_blocking(&kick_request_crit);
  pending_kick = req;
  kick_pending = true;
  critical_section_exit(&kick_request_crit);
}

void start_kick_from_request(const KickStartRequest &req) {
  float decay = exp_map(req.adc0, 0.020f, 0.120f);
  float base_pitch = exp_map(req.adc1, 32.0f, 300.0f);
  float morph = req.adc2 / 4095.0f;

  float sweep_octaves = linear_map(req.adc2, 0.25f, 3.80f);

  float duty = 0.50f - morph * 0.30f;
  duty = clampf_local(duty, 0.08f, 0.92f);

  float drive = 1.35f + morph * 0.90f;

  float duration_seconds = decay * 2.7f + 0.08f;
  if (duration_seconds > 2.8f) duration_seconds = 2.8f;

  voice.active = true;
  voice.sample_index = 0;
  voice.duration_samples = (uint32_t)(duration_seconds * SAMPLE_RATE);
  voice.phase = 0u;

  voice.decay = decay;
  voice.base_pitch = base_pitch;
  voice.morph = morph;
  voice.sweep_octaves = sweep_octaves;
  voice.duty = duty;
  voice.drive = drive;

  voice.click_decay = 0.0045f;
  voice.click_level = 0.20f;
}

void consume_pending_kick_if_any() {
  if (!kick_pending) return;

  KickStartRequest req;
  bool has_request = false;

  critical_section_enter_blocking(&kick_request_crit);
  if (kick_pending) {
    req = pending_kick;
    kick_pending = false;
    has_request = true;
  }
  critical_section_exit(&kick_request_crit);

  if (has_request) {
    start_kick_from_request(req);
  }
}

void update_trig_input() {
  bool trig_now = digitalRead(TRIG_IN_PIN);

  if (trig_last == LOW && trig_now == HIGH) {
    request_kick();
  }

  trig_last = trig_now;
}

void update_button() {
  bool raw = digitalRead(PUSH_BUTTON_PIN);

  if (raw != button_last_raw) {
    button_last_change_ms = millis();
    button_last_raw = raw;
  }

  if ((millis() - button_last_change_ms) > BUTTON_DEBOUNCE_MS) {
    button_prev_stable = button_stable;
    button_stable = raw;

    if (button_prev_stable == HIGH && button_stable == LOW) {
      request_kick();
    }
  }
}

float render_kick_sample() {
  if (!voice.active) {
    return 0.0f;
  }

  if (voice.sample_index >= voice.duration_samples) {
    voice.active = false;
    return 0.0f;
  }

  float t = voice.sample_index / (float)SAMPLE_RATE;

  // Heavy math is intentionally kept here in Ver1.1 for sound matching before optimization.
  float sweep_time = 0.012f + voice.morph * 0.075f;
  float sweep_env = expf(-t / sweep_time);

  float freq = voice.base_pitch * powf(2.0f, voice.sweep_octaves * sweep_env);
  freq = clampf_local(freq, 18.0f, SAMPLE_RATE * 0.40f);

  uint32_t phase_inc = (uint32_t)((freq * 4294967296.0f) / SAMPLE_RATE);
  voice.phase += phase_inc;

  float body_env = expf(-t / fmaxf(voice.decay, 0.006f));
  float click_env = expf(-t / voice.click_decay);

  float tri = osc_triangle(voice.phase);
  float pulse_body = osc_pulse(voice.phase, voice.duty);

  float phase_unit = phase_to_unit(voice.phase);
  float click_phase = phase_unit * (2.0f + voice.morph * 2.0f);
  float pulse_click = osc_pulse_float_phase(click_phase, 0.22f);

  float raw =
    tri * body_env * (0.72f - voice.morph * 0.12f) +
    pulse_body * body_env * (0.22f + voice.morph * 0.16f) +
    pulse_click * click_env * voice.click_level;

  float out = tanhf(raw * voice.drive) * OUTPUT_GAIN;

  if (is_in2_level_half_active()) {
    out *= 0.5f;
  }

  voice.sample_index++;

  return out;
}

void fill_audio_buffer(uint8_t buf_index) {
  // Consume trigger once per buffer. This keeps voice updates on Core1 side.
  consume_pending_kick_if_any();

  if (!voice.active && !kick_pending) {
    uint32_t zero = audio_to_pwm_cc(0.0f);
    for (uint i = 0; i < AUDIO_BLOCK_SIZE; i++) {
      wave_buffer[buf_index][i] = zero;
    }
    return;
  }

  for (uint i = 0; i < AUDIO_BLOCK_SIZE; i++) {
    float sample = render_kick_sample();
    wave_buffer[buf_index][i] = audio_to_pwm_cc(sample);
  }
}

void process_adc_buffer() {
  uint32_t sum0 = 0;
  uint32_t sum1 = 0;
  uint32_t sum2 = 0;

  for (uint i = 0; i < ADC_TOTAL_SAMPLES; i += 3) {
    sum0 += adc_buffer[i + 0];
    sum1 += adc_buffer[i + 1];
    sum2 += adc_buffer[i + 2];
  }

  adc_avg[0] = sum0 / ADC_SAMPLES_PER_CH;
  adc_avg[1] = sum1 / ADC_SAMPLES_PER_CH;

  // ADC2 is inverted by hardware, so reverse it here before using it as morph.
  uint16_t adc2_raw_avg = sum2 / ADC_SAMPLES_PER_CH;
  adc_avg[2] = 4095 - adc2_raw_avg;
}

void restart_adc_dma() {
  adc_fifo_drain();

  dma_channel_set_read_addr(adc_dma_chan, &adc_hw->fifo, false);
  dma_channel_set_write_addr(adc_dma_chan, adc_buffer, false);
  dma_channel_set_trans_count(adc_dma_chan, ADC_TOTAL_SAMPLES, true);
}

void __isr dma_irq_handler() {
  if (dma_channel_get_irq0_status(pwm_dma_chan)) {
    dma_channel_acknowledge_irq0(pwm_dma_chan);

    if (fill_done_id != fill_request_id) {
      audio_underrun = true;

      #if ENABLE_DEBUG_PINS
      gpio_put(UNDERRUN_PIN, 1);
      #endif
    }

    dma_playing_buffer ^= 1;
    buffer_to_fill = dma_playing_buffer ^ 1;

    fill_request_id++;

    dma_channel_set_read_addr(
      pwm_dma_chan,
      wave_buffer[dma_playing_buffer],
      false
    );

    dma_channel_set_trans_count(
      pwm_dma_chan,
      AUDIO_BLOCK_SIZE,
      true
    );
  }

  if (dma_channel_get_irq0_status(adc_dma_chan)) {
    dma_channel_acknowledge_irq0(adc_dma_chan);

    adc_block_ready = true;

    restart_adc_dma();
  }
}

void setup_pwm_dma() {
  gpio_set_function(PWM_AUDIO_PIN, GPIO_FUNC_PWM);

  pwm_slice = pwm_gpio_to_slice_num(PWM_AUDIO_PIN);
  pwm_chan  = pwm_gpio_to_channel(PWM_AUDIO_PIN);

  float clk = (float)clock_get_hz(clk_sys);
  float div = clk / ((float)SAMPLE_RATE * (PWM_WRAP + 1));

  pwm_config cfg = pwm_get_default_config();
  pwm_config_set_wrap(&cfg, PWM_WRAP);
  pwm_config_set_clkdiv(&cfg, div);

  pwm_init(pwm_slice, &cfg, false);
  pwm_set_chan_level(pwm_slice, pwm_chan, PWM_WRAP / 2);

  fill_audio_buffer(0);
  fill_audio_buffer(1);

  pwm_dma_chan = dma_claim_unused_channel(true);
  dma_channel_config c = dma_channel_get_default_config(pwm_dma_chan);

  channel_config_set_transfer_data_size(&c, DMA_SIZE_32);
  channel_config_set_read_increment(&c, true);
  channel_config_set_write_increment(&c, false);
  channel_config_set_dreq(&c, DREQ_PWM_WRAP0 + pwm_slice);

  dma_channel_configure(
    pwm_dma_chan,
    &c,
    &pwm_hw->slice[pwm_slice].cc,
    wave_buffer[0],
    AUDIO_BLOCK_SIZE,
    false
  );

  dma_channel_set_irq0_enabled(pwm_dma_chan, true);

  pwm_set_enabled(pwm_slice, true);
}

void setup_adc_dma() {
  adc_init();

  adc_gpio_init(ADC0_GPIO);
  adc_gpio_init(ADC1_GPIO);
  adc_gpio_init(ADC2_GPIO);

  adc_select_input(0);
  adc_set_round_robin(0b00000111);

  adc_fifo_setup(
    true,
    true,
    1,
    false,
    false
  );

  adc_fifo_drain();

  adc_set_clkdiv(4800.0f);

  adc_dma_chan = dma_claim_unused_channel(true);
  dma_channel_config c = dma_channel_get_default_config(adc_dma_chan);

  channel_config_set_transfer_data_size(&c, DMA_SIZE_16);
  channel_config_set_read_increment(&c, false);
  channel_config_set_write_increment(&c, true);
  channel_config_set_dreq(&c, DREQ_ADC);

  dma_channel_configure(
    adc_dma_chan,
    &c,
    adc_buffer,
    &adc_hw->fifo,
    ADC_TOTAL_SAMPLES,
    false
  );

  dma_channel_set_irq0_enabled(adc_dma_chan, true);
}

void core1_entry() {
  #if ENABLE_DEBUG_PINS
  gpio_init(CORE1_BUSY_PIN);
  gpio_set_dir(CORE1_BUSY_PIN, GPIO_OUT);
  gpio_put(CORE1_BUSY_PIN, 0);
  #endif

  uint32_t last_handled_request = fill_request_id;

  while (true) {
    if (last_handled_request != fill_request_id) {
      core1_is_busy = true;

      #if ENABLE_DEBUG_PINS
      gpio_put(CORE1_BUSY_PIN, 1);
      #endif

      uint32_t request_now = fill_request_id;
      uint8_t target = buffer_to_fill;

      fill_audio_buffer(target);

      last_handled_request = request_now;
      fill_done_id = request_now;

      #if ENABLE_DEBUG_PINS
      gpio_put(CORE1_BUSY_PIN, 0);
      #endif

      core1_is_busy = false;
    }
  }
}

void setup() {
  pinMode(TRIG_IN_PIN, INPUT);
  pinMode(ACCENT_IN_PIN, INPUT);
  pinMode(PUSH_BUTTON_PIN, INPUT_PULLUP);
  pinMode(LED_PIN, OUTPUT);
  digitalWrite(LED_PIN, LOW);

  trig_last = digitalRead(TRIG_IN_PIN);

  button_last_raw = digitalRead(PUSH_BUTTON_PIN);
  button_stable = button_last_raw;
  button_prev_stable = button_last_raw;

  critical_section_init(&kick_request_crit);

  #if ENABLE_DEBUG_PINS
  gpio_init(UNDERRUN_PIN);
  gpio_set_dir(UNDERRUN_PIN, GPIO_OUT);
  gpio_put(UNDERRUN_PIN, 0);
  #endif

  irq_set_exclusive_handler(DMA_IRQ_0, dma_irq_handler);
  irq_set_enabled(DMA_IRQ_0, true);

  setup_pwm_dma();
  setup_adc_dma();

  multicore_launch_core1(core1_entry);

  adc_run(true);

  dma_channel_start(adc_dma_chan);
  dma_channel_start(pwm_dma_chan);
}

void loop() {
  // Core0 handles slow/control tasks only. Audio buffer rendering stays on Core1.
  update_trig_input();
  update_button();

  if (adc_block_ready) {
    adc_block_ready = false;
    process_adc_buffer();
  }
}
