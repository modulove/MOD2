/*
HAGIWO MOD2 LFSR Snare Ver1.0

  • Retro-game-style one-shot snare / slash noise voice based on a deterministic 15-bit LFSR
  • 3 potentiometers → Decay / LFSR clock frequency / Pitch-envelope amount
  • Trigger input (GPIO 7) : rising edge starts one snare voice
  • PUSH button (GPIO 6) : press edge also starts one snare voice
  • Level input (GPIO 0) : HIGH around trigger/playback = output level × 0.5
  • One-shot playback : decay-dependent short noise hit, approximately 0.12 s to 1.04 s
  • Audio engine uses LUT-assisted envelope / clock mapping and no soft clip for higher output level
  • ADC DMA input + PWM DMA output + Dual Core processing

  --Pin assign---
POT1     A0       Snare decay time, 15 ms to 400 ms
POT2     A1       LFSR clock frequency, 1 kHz to 32 kHz
POT3     A2       Pitch-envelope amount, 0 to 4 octaves, reversed ADC
IN1      GPIO7    Trig in, rising edge starts playback
IN2      GPIO0    Level input, HIGH around trigger/playback = output level × 0.5
CV       A2       Shared with POT3
OUT      GPIO1    Audio PWM output (8-bit)
BUTTON   GPIO6    Manual trigger, press edge starts playback
LED      GPIO5    Playback indicator
EEPROM   NA

CC0 1.0 Universal (CC0 1.0) Public Domain Dedication
You can copy, modify, distribute and perform the work, even for commercial purposes, all without asking permission.

Most of the source code was generated by AI.
Although the code has been tested, it may still exhibit unstable behavior or contain incorrect comments.

------------------------------------------------------------------------------
*/

#include <Arduino.h>
#include <math.h>

extern "C" {
  #include "hardware/adc.h"
  #include "hardware/dma.h"
  #include "hardware/pwm.h"
  #include "hardware/irq.h"
  #include "hardware/clocks.h"
  #include "hardware/gpio.h"
  #include "pico/multicore.h"
  #include "pico/critical_section.h"
}

const uint PWM_AUDIO_PIN = 1;

const uint TRIG_IN_PIN = 7;
const uint VOLUME_HALF_IN_PIN = 0;
const uint PUSH_BUTTON_PIN = 6;
const uint MOD2_LED_PIN = 5;

const uint ADC0_GPIO = 26;
const uint ADC1_GPIO = 27;
const uint ADC2_GPIO = 28;

const uint32_t SAMPLE_RATE = 31250;
const uint16_t PWM_WRAP = 255;
const uint AUDIO_BLOCK_SIZE = 256;

const float OUTPUT_GAIN = 0.92f;
const float PI_F = 3.14159265358979323846f;

const int ADC_LUT_SIZE = 4096;
const int EXP2_LUT_SIZE = 257;

const float DECAY_MIN_SECONDS = 0.015f;
const float DECAY_MAX_SECONDS = 0.400f;

const uint32_t IN2_HOLD_MS = 15;
const uint32_t IN2_GRACE_SAMPLES = (SAMPLE_RATE * IN2_HOLD_MS) / 1000;

uint32_t duration_samples_lut[ADC_LUT_SIZE];

float noise_coef_lut[ADC_LUT_SIZE];
float base_clock_lut[ADC_LUT_SIZE];
float pitch_coef_lut[ADC_LUT_SIZE];
float highpass_alpha_lut[ADC_LUT_SIZE];

float exp2_lut[EXP2_LUT_SIZE];

uint32_t wave_buffer[2][AUDIO_BLOCK_SIZE];

volatile uint8_t dma_playing_buffer = 0;
volatile uint8_t buffer_to_fill = 1;

volatile bool core1_is_busy = false;
volatile bool audio_underrun = false;

volatile uint32_t fill_request_id = 0;
volatile uint32_t fill_done_id = 0;

const uint ADC_CH_COUNT = 3;
const uint ADC_SAMPLES_PER_CH = 16;
const uint ADC_TOTAL_SAMPLES = ADC_CH_COUNT * ADC_SAMPLES_PER_CH;

uint16_t adc_buffer[ADC_TOTAL_SAMPLES];

volatile bool adc_block_ready = false;
volatile uint16_t adc_avg[ADC_CH_COUNT] = {0, 0, 0};

int pwm_dma_chan;
int adc_dma_chan;

uint pwm_slice;
uint pwm_chan;

bool trig_last = LOW;

bool button_last_raw = HIGH;
bool button_stable = HIGH;
bool button_prev_stable = HIGH;
uint32_t button_last_change_ms = 0;

uint32_t in2_hold_until_ms = 0;

const uint32_t BUTTON_DEBOUNCE_MS = 20;

struct SnareVoice {
  bool active;

  uint32_t sample_index;
  uint32_t duration_samples;

  uint16_t lfsr;
  float clock_phase;
  float hp_low_state;

  float base_clock_hz;
  float pitch_octaves;

  float noise_env;
  float click_env;
  float pitch_env;

  float noise_coef;
  float click_coef;
  float pitch_coef;

  float highpass_alpha;
  float click_level;
  float noise_level;
  float drive;
  float volume_scale;

  bool in2_applied;
};

struct SnareStartRequest {
  uint16_t adc0;
  uint16_t adc1;
  uint16_t adc2;
  bool in2_active;
};

SnareVoice voice = {
  false,
  0,
  0,
  0x7FFF,
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  1.0f,
  false
};

SnareStartRequest pending_snare = {0, 0, 0, false};
volatile bool snare_pending = false;

critical_section_t snare_request_crit;

float clampf_local(float x, float lo, float hi) {
  if (x < lo) return lo;
  if (x > hi) return hi;
  return x;
}

float exp_map_norm(float norm, float low, float high) {
  return low * powf(high / low, norm);
}

uint32_t make_pwm_cc_value(uint16_t duty) {
  duty &= PWM_WRAP;

  if (pwm_chan == PWM_CHAN_A) {
    return duty;
  } else {
    return ((uint32_t)duty << 16);
  }
}

uint32_t audio_to_pwm_cc(float x) {
  if (x > 1.0f) x = 1.0f;
  if (x < -1.0f) x = -1.0f;

  float y = x * 0.5f + 0.5f;
  uint16_t duty = (uint16_t)(y * PWM_WRAP);

  return make_pwm_cc_value(duty);
}

uint32_t center_pwm_cc() {
  return audio_to_pwm_cc(0.0f);
}

float lookup_exp2_0_4(float x) {
  x = clampf_local(x, 0.0f, 4.0f);

  float pos = x * ((float)(EXP2_LUT_SIZE - 1) * 0.25f);
  int idx = (int)pos;

  if (idx >= EXP2_LUT_SIZE - 1) {
    return exp2_lut[EXP2_LUT_SIZE - 1];
  }

  float frac = pos - (float)idx;
  return exp2_lut[idx] + (exp2_lut[idx + 1] - exp2_lut[idx]) * frac;
}

void advance_lfsr_once() {
  uint16_t bit = (voice.lfsr ^ (voice.lfsr >> 1)) & 1u;
  voice.lfsr = (voice.lfsr >> 1) | (bit << 14);
}

void apply_in2_effect_to_voice() {
  if (voice.in2_applied) return;

  voice.volume_scale = 0.5f;
  voice.in2_applied = true;
}

void setup_luts() {
  for (int i = 0; i < EXP2_LUT_SIZE; i++) {
    float x = 4.0f * (float)i / (float)(EXP2_LUT_SIZE - 1);
    exp2_lut[i] = powf(2.0f, x);
  }

  for (int adc = 0; adc < ADC_LUT_SIZE; adc++) {
    float a = (float)adc / 4095.0f;

    float decay_seconds = exp_map_norm(a, DECAY_MIN_SECONDS, DECAY_MAX_SECONDS);

    float duration_seconds = decay_seconds * 2.4f + 0.080f;

    if (duration_seconds > 2.2f) duration_seconds = 2.2f;
    if (duration_seconds < 0.001f) duration_seconds = 0.001f;

    duration_samples_lut[adc] = (uint32_t)(duration_seconds * SAMPLE_RATE);

    float decay_for_coef = decay_seconds;
    if (decay_for_coef < 0.004f) decay_for_coef = 0.004f;

    noise_coef_lut[adc] = expf(-1.0f / (decay_for_coef * SAMPLE_RATE));

    base_clock_lut[adc] = exp_map_norm(a, 1000.0f, 32000.0f);

    float pitch_env_time = 0.010f + a * 0.070f;
    pitch_coef_lut[adc] = expf(-1.0f / (pitch_env_time * SAMPLE_RATE));

    float hp_cutoff = 900.0f + a * 2600.0f;
    highpass_alpha_lut[adc] = 1.0f - expf(-2.0f * PI_F * hp_cutoff / (float)SAMPLE_RATE);
  }
}

void update_in2_hold() {
  if (gpio_get(VOLUME_HALF_IN_PIN)) {
    in2_hold_until_ms = millis() + IN2_HOLD_MS;
  }
}

bool is_in2_recently_active() {
  if (gpio_get(VOLUME_HALF_IN_PIN)) {
    return true;
  }

  int32_t remaining = (int32_t)(in2_hold_until_ms - millis());
  return remaining > 0;
}

void request_snare() {
  SnareStartRequest req;

  req.adc0 = adc_avg[0];
  req.adc1 = adc_avg[1];
  req.adc2 = adc_avg[2];

  req.in2_active = is_in2_recently_active();

  critical_section_enter_blocking(&snare_request_crit);
  pending_snare = req;
  snare_pending = true;
  critical_section_exit(&snare_request_crit);
}

void start_snare_from_request(const SnareStartRequest &req) {
  uint16_t adc0 = req.adc0;
  uint16_t adc1 = req.adc1;
  uint16_t adc2 = req.adc2;

  if (adc0 > 4095) adc0 = 4095;
  if (adc1 > 4095) adc1 = 4095;
  if (adc2 > 4095) adc2 = 4095;

  float env_amount = (float)adc2 / 4095.0f;

  bool in2_now = gpio_get(VOLUME_HALF_IN_PIN);
  bool in2_active = req.in2_active || in2_now;

  voice.active = true;

  voice.sample_index = 0;
  voice.duration_samples = duration_samples_lut[adc0];

  voice.lfsr = 0x7FFF;
  voice.clock_phase = 0.0f;
  voice.hp_low_state = 0.0f;

  voice.base_clock_hz = base_clock_lut[adc1];
  voice.pitch_octaves = env_amount * 4.0f;

  voice.noise_env = 1.0f;
  voice.click_env = 1.0f;
  voice.pitch_env = 1.0f;

  voice.noise_coef = noise_coef_lut[adc0];

  voice.click_coef = 0.99161f;
  voice.click_level = 0.22f;

  voice.pitch_coef = pitch_coef_lut[adc2];

  voice.highpass_alpha = highpass_alpha_lut[adc2];

  voice.noise_level = 0.78f + env_amount * 0.10f;
  voice.drive = 1.25f + env_amount * 0.55f;
  voice.volume_scale = 1.0f;

  voice.in2_applied = false;

  if (in2_active) {
    apply_in2_effect_to_voice();
  }
}

void consume_pending_snare_if_any() {
  if (!snare_pending) return;

  SnareStartRequest req;
  bool has_request = false;

  critical_section_enter_blocking(&snare_request_crit);
  if (snare_pending) {
    req = pending_snare;
    snare_pending = false;
    has_request = true;
  }
  critical_section_exit(&snare_request_crit);

  if (has_request) {
    start_snare_from_request(req);
  }
}

float render_snare_sample() {
  if (!voice.active) {
    return 0.0f;
  }

  if (!voice.in2_applied && voice.sample_index < IN2_GRACE_SAMPLES) {
    if (gpio_get(VOLUME_HALF_IN_PIN)) {
      apply_in2_effect_to_voice();
    }
  }

  if (voice.sample_index >= voice.duration_samples || voice.noise_env < 0.00020f) {
    voice.active = false;
    return 0.0f;
  }

  float pitch_x = voice.pitch_octaves * voice.pitch_env;
  float pitch_mul = lookup_exp2_0_4(pitch_x);

  float current_clock = voice.base_clock_hz * pitch_mul;

  if (current_clock < 120.0f) current_clock = 120.0f;
  if (current_clock > (float)SAMPLE_RATE * 4.0f) {
    current_clock = (float)SAMPLE_RATE * 4.0f;
  }

  voice.clock_phase += current_clock / (float)SAMPLE_RATE;

  while (voice.clock_phase >= 1.0f) {
    advance_lfsr_once();
    voice.clock_phase -= 1.0f;
  }

  float lfsr_out = (voice.lfsr & 1u) ? 1.0f : -1.0f;

  voice.hp_low_state += voice.highpass_alpha * (lfsr_out - voice.hp_low_state);
  float tone_noise = lfsr_out - voice.hp_low_state;

  float raw = tone_noise * voice.noise_env * voice.noise_level;
  raw += lfsr_out * voice.click_env * voice.click_level;

  // Soft clip removed.
  // Final clipping is handled in audio_to_pwm_cc().
  float out = raw * voice.drive * OUTPUT_GAIN;
  out *= voice.volume_scale;

  voice.noise_env *= voice.noise_coef;
  voice.click_env *= voice.click_coef;
  voice.pitch_env *= voice.pitch_coef;

  voice.sample_index++;

  return out;
}

void fill_audio_buffer(uint8_t buf_index) {
  consume_pending_snare_if_any();

  if (!voice.active && !snare_pending) {
    uint32_t center = center_pwm_cc();

    for (uint i = 0; i < AUDIO_BLOCK_SIZE; i++) {
      wave_buffer[buf_index][i] = center;
    }

    return;
  }

  for (uint i = 0; i < AUDIO_BLOCK_SIZE; i++) {
    float sample = render_snare_sample();
    wave_buffer[buf_index][i] = audio_to_pwm_cc(sample);
  }
}

void update_trig_input() {
  bool trig_now = digitalRead(TRIG_IN_PIN);

  if (trig_last == LOW && trig_now == HIGH) {
    request_snare();
  }

  trig_last = trig_now;
}

void update_button() {
  bool raw = digitalRead(PUSH_BUTTON_PIN);

  if (raw != button_last_raw) {
    button_last_change_ms = millis();
    button_last_raw = raw;
  }

  if ((millis() - button_last_change_ms) > BUTTON_DEBOUNCE_MS) {
    button_prev_stable = button_stable;
    button_stable = raw;

    if (button_prev_stable == HIGH && button_stable == LOW) {
      request_snare();
    }
  }
}

void process_adc_buffer() {
  uint32_t sum0 = 0;
  uint32_t sum1 = 0;
  uint32_t sum2 = 0;

  for (uint i = 0; i < ADC_TOTAL_SAMPLES; i += 3) {
    sum0 += adc_buffer[i + 0];
    sum1 += adc_buffer[i + 1];
    sum2 += adc_buffer[i + 2];
  }

  adc_avg[0] = sum0 / ADC_SAMPLES_PER_CH;
  adc_avg[1] = sum1 / ADC_SAMPLES_PER_CH;

  uint16_t adc2_raw_avg = sum2 / ADC_SAMPLES_PER_CH;
  adc_avg[2] = 4095 - adc2_raw_avg;
}

void restart_adc_dma() {
  adc_fifo_drain();

  dma_channel_set_read_addr(adc_dma_chan, &adc_hw->fifo, false);
  dma_channel_set_write_addr(adc_dma_chan, adc_buffer, false);
  dma_channel_set_trans_count(adc_dma_chan, ADC_TOTAL_SAMPLES, true);
}

void __isr dma_irq_handler() {
  if (dma_channel_get_irq0_status(pwm_dma_chan)) {
    dma_channel_acknowledge_irq0(pwm_dma_chan);

    if (fill_done_id != fill_request_id) {
      audio_underrun = true;
    }

    dma_playing_buffer ^= 1;
    buffer_to_fill = dma_playing_buffer ^ 1;

    fill_request_id++;

    dma_channel_set_read_addr(
      pwm_dma_chan,
      wave_buffer[dma_playing_buffer],
      false
    );

    dma_channel_set_trans_count(
      pwm_dma_chan,
      AUDIO_BLOCK_SIZE,
      true
    );
  }

  if (dma_channel_get_irq0_status(adc_dma_chan)) {
    dma_channel_acknowledge_irq0(adc_dma_chan);

    adc_block_ready = true;

    restart_adc_dma();
  }
}

void setup_pwm_dma() {
  gpio_set_function(PWM_AUDIO_PIN, GPIO_FUNC_PWM);

  pwm_slice = pwm_gpio_to_slice_num(PWM_AUDIO_PIN);
  pwm_chan  = pwm_gpio_to_channel(PWM_AUDIO_PIN);

  float clk = (float)clock_get_hz(clk_sys);
  float div = clk / ((float)SAMPLE_RATE * (PWM_WRAP + 1));

  pwm_config cfg = pwm_get_default_config();
  pwm_config_set_wrap(&cfg, PWM_WRAP);
  pwm_config_set_clkdiv(&cfg, div);

  pwm_init(pwm_slice, &cfg, false);
  pwm_set_chan_level(pwm_slice, pwm_chan, PWM_WRAP / 2);

  fill_audio_buffer(0);
  fill_audio_buffer(1);

  pwm_dma_chan = dma_claim_unused_channel(true);
  dma_channel_config c = dma_channel_get_default_config(pwm_dma_chan);

  channel_config_set_transfer_data_size(&c, DMA_SIZE_32);
  channel_config_set_read_increment(&c, true);
  channel_config_set_write_increment(&c, false);
  channel_config_set_dreq(&c, DREQ_PWM_WRAP0 + pwm_slice);

  dma_channel_configure(
    pwm_dma_chan,
    &c,
    &pwm_hw->slice[pwm_slice].cc,
    wave_buffer[0],
    AUDIO_BLOCK_SIZE,
    false
  );

  dma_channel_set_irq0_enabled(pwm_dma_chan, true);

  pwm_set_enabled(pwm_slice, true);
}

void setup_adc_dma() {
  adc_init();

  adc_gpio_init(ADC0_GPIO);
  adc_gpio_init(ADC1_GPIO);
  adc_gpio_init(ADC2_GPIO);

  adc_select_input(0);
  adc_set_round_robin(0b00000111);

  adc_fifo_setup(
    true,
    true,
    1,
    false,
    false
  );

  adc_fifo_drain();

  adc_set_clkdiv(4800.0f);

  adc_dma_chan = dma_claim_unused_channel(true);
  dma_channel_config c = dma_channel_get_default_config(adc_dma_chan);

  channel_config_set_transfer_data_size(&c, DMA_SIZE_16);
  channel_config_set_read_increment(&c, false);
  channel_config_set_write_increment(&c, true);
  channel_config_set_dreq(&c, DREQ_ADC);

  dma_channel_configure(
    adc_dma_chan,
    &c,
    adc_buffer,
    &adc_hw->fifo,
    ADC_TOTAL_SAMPLES,
    false
  );

  dma_channel_set_irq0_enabled(adc_dma_chan, true);
}

void core1_entry() {
  uint32_t last_handled_request = fill_request_id;

  while (true) {
    if (last_handled_request != fill_request_id) {
      core1_is_busy = true;

      uint32_t request_now = fill_request_id;
      uint8_t target = buffer_to_fill;

      fill_audio_buffer(target);

      fill_done_id = request_now;
      last_handled_request = request_now;

      core1_is_busy = false;
    }

    tight_loop_contents();
  }
}

void setup() {
  pinMode(TRIG_IN_PIN, INPUT);
  pinMode(VOLUME_HALF_IN_PIN, INPUT);
  pinMode(PUSH_BUTTON_PIN, INPUT_PULLUP);
  pinMode(MOD2_LED_PIN, OUTPUT);

  digitalWrite(MOD2_LED_PIN, LOW);

  trig_last = digitalRead(TRIG_IN_PIN);

  button_last_raw = digitalRead(PUSH_BUTTON_PIN);
  button_stable = button_last_raw;
  button_prev_stable = button_last_raw;

  setup_luts();

  critical_section_init(&snare_request_crit);

  irq_set_exclusive_handler(DMA_IRQ_0, dma_irq_handler);
  irq_set_enabled(DMA_IRQ_0, true);

  setup_pwm_dma();
  setup_adc_dma();

  multicore_launch_core1(core1_entry);

  adc_run(true);

  dma_channel_start(adc_dma_chan);
  dma_channel_start(pwm_dma_chan);
}

void loop() {
  update_in2_hold();
  update_trig_input();
  update_button();

  if (adc_block_ready) {
    adc_block_ready = false;
    process_adc_buffer();
  }

  digitalWrite(MOD2_LED_PIN, voice.active ? HIGH : LOW);
}
