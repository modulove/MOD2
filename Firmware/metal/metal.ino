/*
HAGIWO MOD2 01 Metal Hit RP2350 Ver1.0

  - One-shot sound source with inharmonic overtones, like striking metal
  - Three potentiometers control Ring Decay / Metal Spread / Strike Tune
  - A rising edge on trigger input GPIO7 plays one sound
  - BUTTON GPIO6 works as an alternate switch. Each press toggles the PUSH / SW state
  - While PUSH / SW is ON, Strike Tune is raised by 2 octaves
  - The PUSH / SW state is saved to pseudo EEPROM and restored on reboot
  - Accent input GPIO0 is checked at trigger time. If HIGH, that note plays at 50% volume
  - LED GPIO5 lights for 20 msec on trigger
  - ADC and PUSH state are latched at note start. Changes during playback apply from the next note
  - A2 for Strike Tune prioritizes input response and is read once 5 msec after the trigger rising edge
  - The waiting audio buffer is rebuilt immediately after trigger to reduce pitch response delay
  - A0 / A1 are not inverted. Only A2 is inverted by the circuit and corrected in firmware
  - Audio PWM output is 10-bit, PWM update rate is 96 kHz, audio generation rate is 48 kHz
  - Audio processing is kept lightweight using sine LUT, incremental envelopes, and simple soft clipping
  - ADC DMA input + PWM DMA output + dual-core processing

  --Pin assign---
POT1     A0       Ring Decay, 40 ms to 1200 ms, non-inverted
POT2     A1       Metal Spread, ADC1<=100 uses harmonic ratios, 101 and above uses conventional inharmonic ratios, non-inverted
POT3     A2       Strike Tune, 40 Hz base, 1V/oct, inverted ADC corrected in firmware
IN1      GPIO7    Trigger input, rising edge plays one sound
IN2      GPIO0    Accent input, if HIGH at trigger time that note plays at 50% volume
CV       A2       Shared with POT3
OUT      GPIO1    Audio PWM output, 10-bit
BUTTON   GPIO6    PUSH / SW input, internal pullup, toggles ON/OFF on each press, raises Strike Tune by +2 octaves while ON
LED      GPIO5    Lights for 20 msec on trigger
EEPROM   Flash    Saves PUSH / SW state. Commits only once, 100 msec or later after button press


CC0 1.0 Universal (CC0 1.0) Public Domain Dedication
You can copy, modify, distribute and perform the work, even for commercial purposes, all without asking permission.

Most of the source code was generated by AI.
Although the code has been tested by review, it may still exhibit unstable behavior or contain incorrect comments.


------------------------------------------------------------------------------
*/

#include <Arduino.h>
#include <EEPROM.h>
#include <math.h>

extern "C" {
  #include "hardware/adc.h"
  #include "hardware/dma.h"
  #include "hardware/pwm.h"
  #include "hardware/irq.h"
  #include "hardware/clocks.h"
  #include "hardware/gpio.h"
  #include "pico/multicore.h"
  #include "pico/critical_section.h"
  #include "pico/time.h"
}

const uint PWM_AUDIO_PIN = 1;

const uint TRIG_IN_PIN = 7;
const uint ACCENT_IN_PIN = 0;
const uint PUSH_BUTTON_PIN = 6;
const uint LED_PIN = 5;

const uint ADC0_GPIO = 26;
const uint ADC1_GPIO = 27;
const uint ADC2_GPIO = 28;

#define ENABLE_DEBUG_PINS 0

#if ENABLE_DEBUG_PINS
const uint CORE1_BUSY_PIN = 8;
const uint UNDERRUN_PIN = 9;
#endif

const uint32_t SAMPLE_RATE = 48000;
const uint32_t PWM_UPDATE_RATE = SAMPLE_RATE * 2;
const uint16_t PWM_WRAP = 1023;
const uint AUDIO_BLOCK_SIZE = 16;
const uint PWM_REPEAT_COUNT = 2;
const uint PWM_BLOCK_SIZE = AUDIO_BLOCK_SIZE * PWM_REPEAT_COUNT;

const uint SINE_TABLE_BITS = 10;
const uint SINE_TABLE_SIZE = 1u << SINE_TABLE_BITS;
const uint SINE_TABLE_SHIFT = 32u - SINE_TABLE_BITS;
const uint PARTIAL_COUNT = 6;

const float TAU_F = 6.28318530718f;
const float OUTPUT_GAIN = 0.72f;
const float STRIKE_TUNE_BASE_HZ = 40.0f;
const float ADC2_VOLTAGE_RANGE = 5.0f;
const float METAL_SPREAD_MIN = 0.00f;
const float METAL_SPREAD_MAX = 4.20f;
const uint16_t ADC1_CONSONANT_MAX = 100;
const float FIXED_HARDNESS = 2600.0f / 4095.0f;
const float FIXED_DAMPING = 0.12f + (1.0f - 0.12f) * (2500.0f / 4095.0f);

const uint32_t LED_FLASH_MS = 20;
const uint32_t BUTTON_DEBOUNCE_MS = 20;
const uint32_t TRIGGER_ADC_DELAY_US = 5000;
const uint32_t VOICE_ATTACK_SAMPLES = SAMPLE_RATE / 2000;
const uint32_t VOICE_RELEASE_SAMPLES = (SAMPLE_RATE * 3) / 1000;
const uint32_t RETRIGGER_FADE_SAMPLES = (SAMPLE_RATE * 3) / 1000;
const uint32_t PUSH_EEPROM_SAVE_DELAY_MS = 100;
const int EEPROM_SIZE_BYTES = 64;
const uint32_t PUSH_EEPROM_MAGIC = 0x4D483031u;
const uint8_t PUSH_EEPROM_VERSION = 1;
const float ADC_DMA_CLKDIV = 4800.0f;
const float ADC_TRIGGER_CLKDIV = 0.0f;

uint32_t wave_buffer[2][PWM_BLOCK_SIZE];
int16_t sine_table[SINE_TABLE_SIZE];

volatile uint8_t dma_playing_buffer = 0;
volatile uint8_t buffer_to_fill = 1;

volatile bool core1_is_busy = false;
volatile bool audio_underrun = false;

volatile uint32_t fill_request_id = 0;
volatile uint32_t fill_done_id = 0;
volatile uint32_t urgent_fill_request_id = 0;

const uint ADC_CH_COUNT = 3;
const uint ADC_SAMPLES_PER_CH = 16;
const uint ADC_TOTAL_SAMPLES = ADC_CH_COUNT * ADC_SAMPLES_PER_CH;

uint16_t adc_buffer[ADC_TOTAL_SAMPLES];

volatile bool adc_block_ready = false;
volatile uint16_t adc_avg[ADC_CH_COUNT] = {0, 0, 0};

int pwm_dma_chan;
int adc_dma_chan;

uint pwm_slice;
uint pwm_chan;

bool trig_last = LOW;

bool button_last_raw = HIGH;
bool button_stable = HIGH;
bool button_prev_stable = HIGH;
uint32_t button_last_change_ms = 0;

bool push_octave_on = false;
bool saved_push_octave_on = false;
bool push_eeprom_save_pending = false;
uint32_t push_eeprom_save_due_ms = 0;

bool led_is_on = false;
uint32_t led_off_time_ms = 0;

struct PartialState {
  uint32_t phase;
  uint32_t phase_inc;
  float env;
  float env_mul;
  float amp;
};

struct MetalVoice {
  bool active;
  uint32_t sample_index;
  uint32_t duration_samples;
  uint32_t rng;

  PartialState partials[PARTIAL_COUNT];

  float strike_env;
  float strike_env_mul;
  float strike_alpha;
  float strike_lp;
  float strike_amp;

  float shimmer_env;
  float shimmer_env_mul;
  float shimmer_alpha;
  float shimmer_lp;
  float shimmer_amp;

  float accent_gain;
  uint32_t forced_release_remaining;
};

struct MetalStartRequest {
  uint16_t adc0;
  uint16_t adc1;
  uint16_t adc2;
  bool accent_half;
  bool push_on;
};

MetalVoice voice;
MetalVoice tail_voice;

MetalStartRequest pending_hit = {0, 0, 0, false, false};
volatile bool hit_pending = false;

critical_section_t hit_request_crit;

struct PushEepromState {
  uint32_t magic;
  uint8_t version;
  uint8_t push_on;
  uint16_t reserved;
};

float clampf_local(float x, float lo, float hi) {
  if (x < lo) return lo;
  if (x > hi) return hi;
  return x;
}

float exp_map(uint16_t adc, float low, float high) {
  float norm = adc / 4095.0f;
  return low * powf(high / low, norm);
}

float linear_map(uint16_t adc, float low, float high) {
  float norm = adc / 4095.0f;
  return low + (high - low) * norm;
}

float metal_spread_from_adc1(uint16_t adc) {
  if (adc <= ADC1_CONSONANT_MAX) {
    return 0.0f;
  }

  float norm = (adc - ADC1_CONSONANT_MAX) / (4095.0f - ADC1_CONSONANT_MAX);
  return METAL_SPREAD_MIN + (METAL_SPREAD_MAX - METAL_SPREAD_MIN) * norm;
}

float v_oct_pitch_from_adc(uint16_t adc) {
  float volts = (adc / 4095.0f) * ADC2_VOLTAGE_RANGE;
  return STRIKE_TUNE_BASE_HZ * powf(2.0f, volts);
}

uint32_t rand_u32(uint32_t &state) {
  state = state * 1664525u + 1013904223u;
  return state;
}

float rand_bipolar(uint32_t &state) {
  uint32_t value = rand_u32(state);
  return ((value >> 8) * (1.0f / 16777215.0f)) * 2.0f - 1.0f;
}

uint32_t seed_from_request(const MetalStartRequest &req) {
  uint32_t seed = 101u;
  seed ^= (uint32_t)req.adc0 * 73856093u;
  seed ^= (uint32_t)req.adc1 * 19349663u;
  seed ^= (uint32_t)req.adc2 * 83492791u;
  if (req.push_on) {
    seed ^= 0x9E3779B9u;
  }
  return seed;
}

float env_multiplier(float tau_seconds) {
  tau_seconds = fmaxf(tau_seconds, 0.0002f);
  return expf(-1.0f / (tau_seconds * (float)SAMPLE_RATE));
}

float one_pole_alpha(float cutoff_hz) {
  cutoff_hz = clampf_local(cutoff_hz, 10.0f, SAMPLE_RATE * 0.46f);
  return 1.0f - expf(-TAU_F * cutoff_hz / (float)SAMPLE_RATE);
}

uint32_t phase_inc_from_hz(float hz) {
  hz = clampf_local(hz, 0.0f, SAMPLE_RATE * 0.43f);
  return (uint32_t)((hz * 4294967296.0f) / (float)SAMPLE_RATE);
}

float sine_from_phase(uint32_t phase) {
  return sine_table[phase >> SINE_TABLE_SHIFT] * (1.0f / 32768.0f);
}

float soft_clip_fast(float x) {
  x *= 1.35f;
  if (x > 1.5f) return 1.0f;
  if (x < -1.5f) return -1.0f;
  return x - (x * x * x) * (1.0f / 6.0f);
}

uint32_t make_pwm_cc_value(uint16_t duty) {
  if (duty > PWM_WRAP) duty = PWM_WRAP;

  if (pwm_chan == PWM_CHAN_A) {
    return duty;
  } else {
    return ((uint32_t)duty << 16);
  }
}

uint32_t audio_to_pwm_cc(float x) {
  if (x > 1.0f) x = 1.0f;
  if (x < -1.0f) x = -1.0f;

  float y = x * 0.5f + 0.5f;
  uint16_t duty = (uint16_t)(y * PWM_WRAP + 0.5f);

  return make_pwm_cc_value(duty);
}

bool is_in2_level_half_active() {
  return gpio_get(ACCENT_IN_PIN);
}

void load_push_octave_state() {
  EEPROM.begin(EEPROM_SIZE_BYTES);

  PushEepromState state;
  EEPROM.get(0, state);

  if (state.magic == PUSH_EEPROM_MAGIC &&
      state.version == PUSH_EEPROM_VERSION &&
      state.push_on <= 1) {
    push_octave_on = state.push_on != 0;
  } else {
    push_octave_on = false;
  }

  saved_push_octave_on = push_octave_on;
}

void schedule_push_octave_state_save() {
  push_eeprom_save_pending = true;
  push_eeprom_save_due_ms = millis() + PUSH_EEPROM_SAVE_DELAY_MS;
}

void update_push_octave_state_save() {
  if (!push_eeprom_save_pending) return;
  if ((int32_t)(millis() - push_eeprom_save_due_ms) < 0) return;

  push_eeprom_save_pending = false;

  if (saved_push_octave_on == push_octave_on) return;

  PushEepromState state;
  state.magic = PUSH_EEPROM_MAGIC;
  state.version = PUSH_EEPROM_VERSION;
  state.push_on = push_octave_on ? 1 : 0;
  state.reserved = 0;

  EEPROM.put(0, state);
  EEPROM.commit();

  saved_push_octave_on = push_octave_on;
}

float attack_release_gain(const MetalVoice &target_voice) {
  float gain = 1.0f;

  if (target_voice.sample_index < VOICE_ATTACK_SAMPLES) {
    gain *= (float)target_voice.sample_index / (float)VOICE_ATTACK_SAMPLES;
  }

  uint32_t remaining = target_voice.duration_samples - target_voice.sample_index;
  if (remaining <= VOICE_RELEASE_SAMPLES) {
    if (remaining <= 1) {
      gain = 0.0f;
    } else {
      gain *= (float)(remaining - 1) / (float)VOICE_RELEASE_SAMPLES;
    }
  }

  if (target_voice.forced_release_remaining > 0) {
    if (target_voice.forced_release_remaining <= 1) {
      gain = 0.0f;
    } else {
      gain *= (float)(target_voice.forced_release_remaining - 1) / (float)RETRIGGER_FADE_SAMPLES;
    }
  }

  return gain;
}

void build_sine_table() {
  for (uint i = 0; i < SINE_TABLE_SIZE; i++) {
    float phase = ((float)i / (float)SINE_TABLE_SIZE) * TAU_F;
    sine_table[i] = (int16_t)(sinf(phase) * 32767.0f);
  }
}

void flash_led_for_trigger() {
  led_is_on = true;
  led_off_time_ms = millis() + LED_FLASH_MS;
  digitalWrite(LED_PIN, HIGH);
}

uint16_t read_adc2_for_trigger() {
  dma_channel_set_irq0_enabled(adc_dma_chan, false);
  adc_run(false);
  dma_channel_abort(adc_dma_chan);

  if (dma_channel_get_irq0_status(adc_dma_chan)) {
    dma_channel_acknowledge_irq0(adc_dma_chan);
  }

  adc_fifo_drain();
  adc_set_round_robin(0);
  adc_select_input(2);
  adc_set_clkdiv(ADC_TRIGGER_CLKDIV);

  (void)adc_read();
  uint16_t adc2_raw = adc_read();
  uint16_t adc2_corrected = 4095 - adc2_raw;

  adc_select_input(0);
  adc_set_round_robin(0b00000111);
  adc_set_clkdiv(ADC_DMA_CLKDIV);
  adc_block_ready = false;
  restart_adc_dma();
  dma_channel_set_irq0_enabled(adc_dma_chan, true);
  adc_run(true);

  return adc2_corrected;
}

void request_metal_hit(bool accent_half) {
  MetalStartRequest req;

  req.adc0 = adc_avg[0];
  req.adc1 = adc_avg[1];
  req.adc2 = read_adc2_for_trigger();
  req.accent_half = accent_half;
  req.push_on = push_octave_on;

  critical_section_enter_blocking(&hit_request_crit);
  pending_hit = req;
  hit_pending = true;
  urgent_fill_request_id++;
  critical_section_exit(&hit_request_crit);
}

void trigger_metal_hit_after_adc_settle() {
  bool accent_half = is_in2_level_half_active();

  flash_led_for_trigger();
  busy_wait_us_32(TRIGGER_ADC_DELAY_US);
  request_metal_hit(accent_half);
}

void start_voice_from_request(const MetalStartRequest &req) {
  if (voice.active) {
    tail_voice = voice;
    tail_voice.forced_release_remaining = RETRIGGER_FADE_SAMPLES;
  }

  float decay = exp_map(req.adc0, 0.040f, 1.200f);
  float spread = metal_spread_from_adc1(req.adc1);
  float pitch = v_oct_pitch_from_adc(req.adc2);
  if (req.push_on) {
    pitch *= 4.0f;
  }

  float duration_seconds = decay * (2.55f - FIXED_DAMPING * 0.80f) + 0.12f;
  if (duration_seconds > 3.5f) duration_seconds = 3.5f;

  voice.active = true;
  voice.sample_index = 0;
  voice.duration_samples = (uint32_t)(duration_seconds * SAMPLE_RATE);
  voice.rng = seed_from_request(req);
  voice.accent_gain = req.accent_half ? 0.5f : 1.0f;
  voice.forced_release_remaining = 0;

  const bool use_consonant_ratios = req.adc1 <= ADC1_CONSONANT_MAX;
  const float consonant_ratios[PARTIAL_COUNT] = {1.00f, 2.00f, 3.00f, 4.00f, 5.00f, 6.00f};
  const float base_ratios[PARTIAL_COUNT] = {1.00f, 1.39f, 2.16f, 3.08f, 4.37f, 5.91f};
  const float spread_amounts[PARTIAL_COUNT] = {0.00f, 0.07f, 0.23f, 0.39f, 0.61f, 0.83f};

  for (uint i = 0; i < PARTIAL_COUNT; i++) {
    float ratio = use_consonant_ratios
      ? consonant_ratios[i]
      : base_ratios[i] + spread * spread_amounts[i];
    float partial_freq = clampf_local(pitch * ratio, 35.0f, SAMPLE_RATE * 0.43f);
    float partial_decay = decay * (1.42f - FIXED_DAMPING * 0.72f);
    partial_decay /= 1.0f + i * (0.16f + FIXED_DAMPING * 0.13f);

    float amp_random = 1.0f + rand_bipolar(voice.rng) * 0.10f;
    float amp = (0.55f / (1.0f + i * 0.62f)) * amp_random;

    voice.partials[i].phase = rand_u32(voice.rng);
    voice.partials[i].phase_inc = phase_inc_from_hz(partial_freq);
    voice.partials[i].env = 1.0f;
    voice.partials[i].env_mul = env_multiplier(fmaxf(0.012f, partial_decay));
    voice.partials[i].amp = amp;
  }

  float strike_cutoff = 2600.0f + FIXED_HARDNESS * 9000.0f;
  float strike_tau = 0.0018f + (1.0f - FIXED_HARDNESS) * 0.010f;
  voice.strike_env = 1.0f;
  voice.strike_env_mul = env_multiplier(strike_tau);
  voice.strike_alpha = one_pole_alpha(strike_cutoff);
  voice.strike_lp = 0.0f;
  voice.strike_amp = 0.13f + FIXED_HARDNESS * 0.34f;

  float shimmer_cutoff = 1100.0f + spread * 1700.0f;
  float shimmer_tau = fmaxf(0.025f, decay * (0.18f + spread * 0.05f));
  voice.shimmer_env = 1.0f;
  voice.shimmer_env_mul = env_multiplier(shimmer_tau);
  voice.shimmer_alpha = one_pole_alpha(shimmer_cutoff);
  voice.shimmer_lp = 0.0f;
  voice.shimmer_amp = 0.04f + spread * 0.035f;
}

void consume_pending_hit_if_any() {
  if (!hit_pending) return;

  MetalStartRequest req;
  bool has_request = false;

  critical_section_enter_blocking(&hit_request_crit);
  if (hit_pending) {
    req = pending_hit;
    hit_pending = false;
    has_request = true;
  }
  critical_section_exit(&hit_request_crit);

  if (has_request) {
    start_voice_from_request(req);
  }
}

void update_trig_input() {
  bool trig_now = digitalRead(TRIG_IN_PIN);

  if (trig_last == LOW && trig_now == HIGH) {
    trigger_metal_hit_after_adc_settle();
  }

  trig_last = trig_now;
}

void update_button_toggle() {
  bool raw = digitalRead(PUSH_BUTTON_PIN);

  if (raw != button_last_raw) {
    button_last_change_ms = millis();
    button_last_raw = raw;
  }

  if ((millis() - button_last_change_ms) > BUTTON_DEBOUNCE_MS) {
    button_prev_stable = button_stable;
    button_stable = raw;

    if (button_prev_stable == HIGH && button_stable == LOW) {
      push_octave_on = !push_octave_on;
      schedule_push_octave_state_save();
    }
  }
}

void update_led() {
  if (led_is_on && ((int32_t)(millis() - led_off_time_ms) >= 0)) {
    led_is_on = false;
    digitalWrite(LED_PIN, LOW);
  }
}

float render_voice_raw_sample(MetalVoice &target_voice) {
  if (!target_voice.active) {
    return 0.0f;
  }

  if (target_voice.sample_index >= target_voice.duration_samples) {
    target_voice.active = false;
    return 0.0f;
  }

  bool forced_release_active = target_voice.forced_release_remaining > 0;
  float voice_gain = attack_release_gain(target_voice) * target_voice.accent_gain;
  float raw = 0.0f;

  for (uint i = 0; i < PARTIAL_COUNT; i++) {
    PartialState &partial = target_voice.partials[i];
    raw += sine_from_phase(partial.phase) * partial.env * partial.amp;
    partial.phase += partial.phase_inc;
    partial.env *= partial.env_mul;
  }

  float noise = rand_bipolar(target_voice.rng);

  target_voice.strike_lp += target_voice.strike_alpha * (noise - target_voice.strike_lp);
  float strike_hp = noise - target_voice.strike_lp;
  raw += strike_hp * target_voice.strike_env * target_voice.strike_amp;
  target_voice.strike_env *= target_voice.strike_env_mul;

  target_voice.shimmer_lp += target_voice.shimmer_alpha * (noise - target_voice.shimmer_lp);
  float shimmer_hp = noise - target_voice.shimmer_lp;
  raw += shimmer_hp * target_voice.shimmer_env * target_voice.shimmer_amp;
  target_voice.shimmer_env *= target_voice.shimmer_env_mul;

  target_voice.sample_index++;

  if (target_voice.forced_release_remaining > 0) {
    target_voice.forced_release_remaining--;
  }

  if (target_voice.sample_index >= target_voice.duration_samples ||
      (forced_release_active && target_voice.forced_release_remaining == 0)) {
    target_voice.active = false;
  }

  return raw * voice_gain;
}

float render_metal_sample() {
  float raw = 0.0f;

  raw += render_voice_raw_sample(voice);
  raw += render_voice_raw_sample(tail_voice);

  return soft_clip_fast(raw) * OUTPUT_GAIN;
}

void fill_audio_buffer(uint8_t buf_index) {
  consume_pending_hit_if_any();

  if (!voice.active && !tail_voice.active && !hit_pending) {
    uint32_t zero = audio_to_pwm_cc(0.0f);
    for (uint i = 0; i < PWM_BLOCK_SIZE; i++) {
      wave_buffer[buf_index][i] = zero;
    }
    return;
  }

  uint out_index = 0;
  for (uint i = 0; i < AUDIO_BLOCK_SIZE; i++) {
    float sample = render_metal_sample();
    uint32_t cc = audio_to_pwm_cc(sample);

    for (uint repeat = 0; repeat < PWM_REPEAT_COUNT; repeat++) {
      wave_buffer[buf_index][out_index++] = cc;
    }
  }
}

void process_adc_buffer() {
  uint32_t sum0 = 0;
  uint32_t sum1 = 0;
  uint32_t sum2 = 0;

  for (uint i = 0; i < ADC_TOTAL_SAMPLES; i += 3) {
    sum0 += adc_buffer[i + 0];
    sum1 += adc_buffer[i + 1];
    sum2 += adc_buffer[i + 2];
  }

  adc_avg[0] = sum0 / ADC_SAMPLES_PER_CH;
  adc_avg[1] = sum1 / ADC_SAMPLES_PER_CH;

  uint16_t adc2_raw_avg = sum2 / ADC_SAMPLES_PER_CH;
  adc_avg[2] = 4095 - adc2_raw_avg;
}

void restart_adc_dma() {
  adc_fifo_drain();

  dma_channel_set_read_addr(adc_dma_chan, &adc_hw->fifo, false);
  dma_channel_set_write_addr(adc_dma_chan, adc_buffer, false);
  dma_channel_set_trans_count(adc_dma_chan, ADC_TOTAL_SAMPLES, true);
}

void __isr dma_irq_handler() {
  if (dma_channel_get_irq0_status(pwm_dma_chan)) {
    dma_channel_acknowledge_irq0(pwm_dma_chan);

    if (fill_done_id != fill_request_id) {
      audio_underrun = true;

      #if ENABLE_DEBUG_PINS
      gpio_put(UNDERRUN_PIN, 1);
      #endif
    }

    dma_playing_buffer ^= 1;
    buffer_to_fill = dma_playing_buffer ^ 1;

    fill_request_id++;

    dma_channel_set_read_addr(
      pwm_dma_chan,
      wave_buffer[dma_playing_buffer],
      false
    );

    dma_channel_set_trans_count(
      pwm_dma_chan,
      PWM_BLOCK_SIZE,
      true
    );
  }

  if (dma_channel_get_irq0_status(adc_dma_chan)) {
    dma_channel_acknowledge_irq0(adc_dma_chan);

    adc_block_ready = true;

    restart_adc_dma();
  }
}

void setup_pwm_dma() {
  gpio_set_function(PWM_AUDIO_PIN, GPIO_FUNC_PWM);

  pwm_slice = pwm_gpio_to_slice_num(PWM_AUDIO_PIN);
  pwm_chan = pwm_gpio_to_channel(PWM_AUDIO_PIN);

  float clk = (float)clock_get_hz(clk_sys);
  float div = clk / ((float)PWM_UPDATE_RATE * (PWM_WRAP + 1));

  pwm_config cfg = pwm_get_default_config();
  pwm_config_set_wrap(&cfg, PWM_WRAP);
  pwm_config_set_clkdiv(&cfg, div);

  pwm_init(pwm_slice, &cfg, false);
  pwm_set_chan_level(pwm_slice, pwm_chan, PWM_WRAP / 2);

  fill_audio_buffer(0);
  fill_audio_buffer(1);

  pwm_dma_chan = dma_claim_unused_channel(true);
  dma_channel_config c = dma_channel_get_default_config(pwm_dma_chan);

  channel_config_set_transfer_data_size(&c, DMA_SIZE_32);
  channel_config_set_read_increment(&c, true);
  channel_config_set_write_increment(&c, false);
  channel_config_set_dreq(&c, DREQ_PWM_WRAP0 + pwm_slice);

  dma_channel_configure(
    pwm_dma_chan,
    &c,
    &pwm_hw->slice[pwm_slice].cc,
    wave_buffer[0],
    PWM_BLOCK_SIZE,
    false
  );

  dma_channel_set_irq0_enabled(pwm_dma_chan, true);

  pwm_set_enabled(pwm_slice, true);
}

void setup_adc_dma() {
  adc_init();

  adc_gpio_init(ADC0_GPIO);
  adc_gpio_init(ADC1_GPIO);
  adc_gpio_init(ADC2_GPIO);

  adc_select_input(0);
  adc_set_round_robin(0b00000111);

  adc_fifo_setup(
    true,
    true,
    1,
    false,
    false
  );

  adc_fifo_drain();

  adc_set_clkdiv(ADC_DMA_CLKDIV);

  adc_dma_chan = dma_claim_unused_channel(true);
  dma_channel_config c = dma_channel_get_default_config(adc_dma_chan);

  channel_config_set_transfer_data_size(&c, DMA_SIZE_16);
  channel_config_set_read_increment(&c, false);
  channel_config_set_write_increment(&c, true);
  channel_config_set_dreq(&c, DREQ_ADC);

  dma_channel_configure(
    adc_dma_chan,
    &c,
    adc_buffer,
    &adc_hw->fifo,
    ADC_TOTAL_SAMPLES,
    false
  );

  dma_channel_set_irq0_enabled(adc_dma_chan, true);
}

void core1_entry() {
  #if ENABLE_DEBUG_PINS
  gpio_init(CORE1_BUSY_PIN);
  gpio_set_dir(CORE1_BUSY_PIN, GPIO_OUT);
  gpio_put(CORE1_BUSY_PIN, 0);
  #endif

  uint32_t last_handled_request = fill_request_id;
  uint32_t last_urgent_request = urgent_fill_request_id;

  while (true) {
    uint32_t request_now = fill_request_id;
    uint32_t urgent_now = urgent_fill_request_id;

    if (last_handled_request != request_now || last_urgent_request != urgent_now) {
      core1_is_busy = true;

      #if ENABLE_DEBUG_PINS
      gpio_put(CORE1_BUSY_PIN, 1);
      #endif

      uint8_t target = buffer_to_fill;

      fill_audio_buffer(target);

      last_handled_request = request_now;
      last_urgent_request = urgent_now;
      fill_done_id = request_now;

      #if ENABLE_DEBUG_PINS
      gpio_put(CORE1_BUSY_PIN, 0);
      #endif

      core1_is_busy = false;
    }
  }
}

void setup() {
  pinMode(TRIG_IN_PIN, INPUT);
  pinMode(ACCENT_IN_PIN, INPUT);
  pinMode(PUSH_BUTTON_PIN, INPUT_PULLUP);
  pinMode(LED_PIN, OUTPUT);
  digitalWrite(LED_PIN, LOW);

  trig_last = digitalRead(TRIG_IN_PIN);

  button_last_raw = digitalRead(PUSH_BUTTON_PIN);
  button_stable = button_last_raw;
  button_prev_stable = button_last_raw;

  load_push_octave_state();

  critical_section_init(&hit_request_crit);
  build_sine_table();

  #if ENABLE_DEBUG_PINS
  gpio_init(UNDERRUN_PIN);
  gpio_set_dir(UNDERRUN_PIN, GPIO_OUT);
  gpio_put(UNDERRUN_PIN, 0);
  #endif

  irq_set_exclusive_handler(DMA_IRQ_0, dma_irq_handler);
  irq_set_enabled(DMA_IRQ_0, true);

  setup_pwm_dma();
  setup_adc_dma();

  multicore_launch_core1(core1_entry);

  adc_run(true);

  dma_channel_start(adc_dma_chan);
  dma_channel_start(pwm_dma_chan);
}

void loop() {
  update_trig_input();
  update_button_toggle();
  update_push_octave_state_save();
  update_led();

  if (adc_block_ready) {
    adc_block_ready = false;
    process_adc_buffer();
  }
}
