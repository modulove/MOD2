/*
HAGIWO MOD2 Radio Sampler Ver1.0

  • Single long-form audio file (up to ~130 seconds at 36.6kHz)
  • Optimized for vocal/speech/podcast sampling for techno production
  • Variable playback speed with pitch shifting (0.5× to 1.5×)
  • Start position control for selecting different sections
  • Forward/Reverse playback direction switching
  • PWM audio output at ~36.6 kHz using 10-bit resolution
  • Linear interpolation for smooth pitch-shifting

  --Pin assign---
POT1     A0       Playback speed control (0.5×–1.5×)
POT2     A1       Direction switch (< 512 = forward, >= 512 = reverse)
POT3     A2       Start position in sample (0-100%)
IN1      GPIO7    External trigger (rising-edge)
IN2      GPIO0    Loop mode toggle (LOW = one-shot, HIGH = loop)
CV       A2       Shared with POT3 for CV control of position
BUTTON   GPIO6    Manual trigger (active-low, pull-up)
OUT      GPIO1    10-bit PWM audio output (~36.6 kHz)
LED      GPIO5    Trigger LED indicator (20 ms pulse)
EEPROM   N/A

CC0 1.0 Universal (CC0 1.0) Public Domain Dedication
You can copy, modify, distribute and perform the work, even for commercial purposes, all without asking permission.

Most of the source code was generated by AI.
Although the code has been tested, it may still exhibit unstable behavior or contain incorrect comments.
*/

#include <Arduino.h>
#include "hardware/pwm.h"
#include "hardware/irq.h"
#include "sample.h"   // Header file containing the single long-form sample

#define FRAC_BITS    12
#define FRAC_MASK    ((1UL << FRAC_BITS) - 1)

const uint16_t PWM_FS   = 1023;
const uint16_t PWM_MID  = PWM_FS / 2;
const uint16_t PWM_WRAP = 4095;

volatile bool     playing      = false;
volatile uint32_t tblAcc       = 0;
volatile uint32_t tblStepFP    = 1UL << FRAC_BITS;
volatile bool     isReverse    = false;
volatile bool     loopMode     = false;
volatile uint32_t startPos16   = 0;
volatile uint32_t endPos16     = 0;

uint sliceAudio, sliceIRQ;

volatile bool ledOn     = false;
uint32_t     ledOnTime = 0;

// Read 16-bit PCM sample from byte array
inline int16_t readPCM(const volatile uint8_t* base, uint32_t idx) {
  uint32_t byteIndex = idx << 1;
  return int16_t(base[byteIndex] | (base[byteIndex + 1] << 8));
}

// PWM interrupt handler - generates audio output
void on_pwm_wrap() {
  pwm_clear_irq(sliceIRQ);

  if (!playing) {
    pwm_set_chan_level(sliceAudio, PWM_CHAN_B, PWM_MID);
    return;
  }

  uint32_t idx  = tblAcc >> FRAC_BITS;
  uint32_t frac = tblAcc & FRAC_MASK;

  // Check boundaries
  if (!isReverse) {
    // Forward playback
    if (idx >= endPos16) {
      if (loopMode) {
        tblAcc = startPos16 << FRAC_BITS;
      } else {
        playing = false;
        tblAcc  = startPos16 << FRAC_BITS;
        pwm_set_chan_level(sliceAudio, PWM_CHAN_B, PWM_MID);
        return;
      }
    }
  } else {
    // Reverse playback
    if (idx <= startPos16 || idx >= SAMPLE_LENGTH) {
      if (loopMode) {
        tblAcc = (endPos16 - 1) << FRAC_BITS;
      } else {
        playing = false;
        tblAcc  = startPos16 << FRAC_BITS;
        pwm_set_chan_level(sliceAudio, PWM_CHAN_B, PWM_MID);
        return;
      }
    }
  }

  idx = tblAcc >> FRAC_BITS;
  frac = tblAcc & FRAC_MASK;

  // Linear interpolation for smooth playback
  int16_t s1 = readPCM(vocalSample, idx);
  int16_t s2;

  if (!isReverse) {
    s2 = (idx + 1 < endPos16) ? readPCM(vocalSample, idx + 1) : 0;
  } else {
    s2 = (idx > startPos16) ? readPCM(vocalSample, idx - 1) : 0;
  }

  int32_t mix = ((int32_t)s1 * ((1UL<<FRAC_BITS) - frac) + (int32_t)s2 * frac) >> FRAC_BITS;
  int16_t interpolated = int16_t(mix);

  // Convert to PWM value
  uint16_t pwmVal = uint16_t(int32_t(interpolated) + 32768) >> 6;
  pwm_set_chan_level(sliceAudio, PWM_CHAN_B, pwmVal);

  // Advance position
  if (!isReverse) {
    tblAcc += tblStepFP;
  } else {
    // In reverse, subtract the step
    if (tblAcc >= tblStepFP) {
      tblAcc -= tblStepFP;
    } else {
      tblAcc = startPos16 << FRAC_BITS;
      if (loopMode) {
        tblAcc = (endPos16 - 1) << FRAC_BITS;
      } else {
        playing = false;
      }
    }
  }
}

void onTrigger() {
  playing = false;
  delay(5);

  // Read POT3 (A2) for start position (0-100% of sample)
  uint16_t posVal = 1023 - analogRead(A2);
  uint32_t startPercent = (uint32_t)posVal * 100UL / 1023UL;

  // Calculate start position (0-100% of sample length)
  startPos16 = (SAMPLE_LENGTH * startPercent) / 100UL;

  // Set end position based on a reasonable snippet length
  // Default: play from start to end of sample
  endPos16 = SAMPLE_LENGTH;

  // Read POT2 (A1) for direction
  uint16_t dirVal = analogRead(A1);
  isReverse = (dirVal >= 512);

  // Set initial position based on direction
  if (!isReverse) {
    tblAcc = startPos16 << FRAC_BITS;
  } else {
    tblAcc = (endPos16 - 1) << FRAC_BITS;
  }

  // Read POT1 (A0) for playback speed (0.5× to 1.5×)
  uint16_t raw = analogRead(A0);
  float rate   = 0.5f + (raw / 1023.0f);
  tblStepFP    = uint32_t(rate * float(1 << FRAC_BITS));

  // Read IN2 (GPIO0) for loop mode
  loopMode = (digitalRead(0) == HIGH);

  // LED indicator
  digitalWrite(5, HIGH);
  ledOn     = true;
  ledOnTime = millis();

  playing = true;
}

void setup() {
  analogReadResolution(10);

  pinMode(0, INPUT);       // IN2 - Loop mode
  pinMode(5, OUTPUT);      // LED
  digitalWrite(5, LOW);

  // Setup PWM for audio output
  pinMode(1, OUTPUT);
  gpio_set_function(1, GPIO_FUNC_PWM);
  pinMode(2, OUTPUT);
  gpio_set_function(2, GPIO_FUNC_PWM);
  sliceAudio = pwm_gpio_to_slice_num(1);
  sliceIRQ   = pwm_gpio_to_slice_num(2);

  pwm_set_clkdiv(sliceAudio, 1);
  pwm_set_wrap  (sliceAudio, PWM_FS);
  pwm_set_enabled(sliceAudio, true);

  pwm_set_clkdiv(sliceIRQ, 1);
  pwm_set_wrap  (sliceIRQ, PWM_WRAP);
  pwm_set_enabled(sliceIRQ, true);
  pwm_clear_irq     (sliceIRQ);
  pwm_set_irq_enabled(sliceIRQ, true);
  irq_set_exclusive_handler(PWM_IRQ_WRAP, on_pwm_wrap);
  irq_set_enabled(PWM_IRQ_WRAP, true);

  // Trigger inputs
  pinMode(7, INPUT);       // IN1 - External trigger
  attachInterrupt(digitalPinToInterrupt(7), onTrigger, RISING);
  pinMode(6, INPUT_PULLUP); // Button
  attachInterrupt(digitalPinToInterrupt(6), onTrigger, FALLING);
}

void loop() {
  // LED pulse control
  if (ledOn && (millis() - ledOnTime >= 20)) {
    digitalWrite(5, LOW);
    ledOn = false;
  }
}
