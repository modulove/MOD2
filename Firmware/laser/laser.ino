/*
HAGIWO MOD2 Arcade Laser Ver1.0

  • One-shot arcade laser voice with a 12-shape wavetable morph oscillator
  • 3 potentiometers with PUSH/SW two-page editing
  • SW OFF : Decay / Decay Envelope / Wavetable Morph
  • SW ON  : Pitch Width / Pitch Envelope / End Pitch
  • Trigger input (GPIO 7) : rising edge starts one laser voice
  • PUSH button (GPIO 6) : alternate edit-page toggle, active LOW, with per-ADC soft takeover
  • Level input (GPIO 0) : HIGH around trigger/playback = output level × 0.5
  • LED (GPIO 5) : 10 ms trigger blink, dim 10% while editing SW ON page
  • Parameters are stored in on-board flash after PUSH press, delayed until audio is idle
  • Audio output uses 10-bit PWM at 31.25 kHz, scaled to use full PWM range
  • ADC DMA input + PWM DMA output + Dual Core processing
  • ADC DMA is re-armed from ADC0 each block to prevent ADC1/ADC2 channel-order drift

  --Pin assign---
POT1     A0       SW OFF: Decay, SW ON: Pitch Width
POT2     A1       SW OFF: Decay Envelope, SW ON: Pitch Envelope
POT3     A2       SW OFF: Wavetable Morph, SW ON: End Pitch, reversed ADC
IN1      GPIO7    Trig in, active HIGH, rising edge starts playback
IN2      GPIO0    Level input, active HIGH, HIGH around trigger/playback = output level × 0.5
CV       A2       Shared with POT3
OUT      GPIO1    Audio PWM output (10-bit)
BUTTON   GPIO6    Alternate edit-page toggle, active LOW, press edge toggles page
LED      GPIO5    10 ms trigger blink, 10% PWM while SW ON page
EEPROM   save 6 sound parameters, delayed Flash commit

CC0 1.0 Universal (CC0 1.0) Public Domain Dedication
You can copy, modify, distribute and perform the work, even for commercial purposes, all without asking permission.

Most of the source code was generated by AI.
Although the code has been tested by review, it may still exhibit unstable behavior or contain incorrect comments.

------------------------------------------------------------------------------
*/

#include <Arduino.h>
#include <math.h>
#include <EEPROM.h>
#include <string.h>

extern "C" {
  #include "hardware/adc.h"
  #include "hardware/dma.h"
  #include "hardware/pwm.h"
  #include "hardware/irq.h"
  #include "hardware/clocks.h"
  #include "hardware/gpio.h"
  #include "pico/multicore.h"
  #include "pico/critical_section.h"
}

const uint PWM_AUDIO_PIN = 1;

const uint TRIG_IN_PIN = 7;
const uint VOLUME_HALF_IN_PIN = 0;
const uint PUSH_BUTTON_PIN = 6;
const uint MOD2_LED_PIN = 5;

const uint ADC0_GPIO = 26;
const uint ADC1_GPIO = 27;
const uint ADC2_GPIO = 28;

const uint32_t SAMPLE_RATE = 31250;
const uint16_t PWM_WRAP = 1023;
const uint AUDIO_BLOCK_SIZE = 256;

// voice.gain is 0.88f. 1.0 / 0.88 = 1.13636.
// Normal output therefore reaches approximately full scale before final clipping.
const float OUTPUT_GAIN = 1.13636f;

const float TWO_PI_F = 6.28318530717958647692f;

const int ADC_LUT_SIZE = 4096;
const int WAVE_COUNT = 12;
const int WAVE_TABLE_SIZE = 256;
const int WAVE_TABLE_MASK = WAVE_TABLE_SIZE - 1;

const float DECAY_MIN_SECONDS = 0.020f;
const float DECAY_MAX_SECONDS = 0.500f;
const float AMP_CURVE_MIN = 0.62f;
const float AMP_CURVE_MAX = 2.75f;
const float PITCH_WIDTH_MIN_OCT = 0.0f;
const float PITCH_WIDTH_MAX_OCT = 4.0f;
const float PITCH_TAU_MIN_SECONDS = 0.012f;
const float PITCH_TAU_MAX_SECONDS = 0.220f;
const float END_PITCH_MIN_HZ = 45.0f;
const float END_PITCH_MAX_HZ = 2400.0f;

const int PICKUP_THRESHOLD = 100;

const uint32_t IN2_HOLD_MS = 15;
const uint32_t IN2_GRACE_SAMPLES = (SAMPLE_RATE * IN2_HOLD_MS) / 1000;
const uint32_t BUTTON_DEBOUNCE_MS = 20;
const uint32_t LED_BLINK_MS = 10;

const uint16_t LED_PWM_WRAP = 999;
const uint16_t LED_LEVEL_OFF = 0;
const uint16_t LED_LEVEL_DIM = 100;
const uint16_t LED_LEVEL_FULL = 999;

const uint32_t EEPROM_MAGIC = 0x414C4153UL;  // "ALAS" = Arcade Laser save.
const uint16_t EEPROM_VERSION = 1;
const int EEPROM_SIZE_BYTES = 128;

const uint32_t SAVE_IDLE_DELAY_MS = 1500;

float decay_lut[ADC_LUT_SIZE];
float amplitude_curve_lut[ADC_LUT_SIZE];
float wave_position_lut[ADC_LUT_SIZE];
float pitch_width_lut[ADC_LUT_SIZE];
float pitch_tau_lut[ADC_LUT_SIZE];
float end_pitch_lut[ADC_LUT_SIZE];

float wavetable[WAVE_COUNT][WAVE_TABLE_SIZE + 1];

uint32_t wave_buffer[2][AUDIO_BLOCK_SIZE];

volatile uint8_t dma_playing_buffer = 0;
volatile uint8_t buffer_to_fill = 1;

volatile bool core1_is_busy = false;
volatile bool audio_underrun = false;

volatile uint32_t fill_request_id = 0;
volatile uint32_t fill_done_id = 0;

const uint ADC_CH_COUNT = 3;
const uint ADC_SAMPLES_PER_CH = 16;
const uint ADC_TOTAL_SAMPLES = ADC_CH_COUNT * ADC_SAMPLES_PER_CH;

uint16_t adc_buffer[ADC_TOTAL_SAMPLES];

volatile bool adc_block_ready = false;
volatile bool adc_restart_requested = false;

volatile uint16_t adc_avg[ADC_CH_COUNT] = {0, 0, 0};

int pwm_dma_chan;
int adc_dma_chan;

uint pwm_slice;
uint pwm_chan;

uint led_pwm_slice;
uint led_pwm_chan;

bool trig_last = LOW;

bool button_last_raw = HIGH;
bool button_stable = HIGH;
bool button_prev_stable = HIGH;
uint32_t button_last_change_ms = 0;

bool edit_page_on = false;

uint16_t pickup_origin[3] = {0, 0, 0};
bool picked_up[3] = {true, true, true};
bool pickup_rearm_pending = false;

uint32_t in2_hold_until_ms = 0;
uint32_t led_on_until_ms = 0;

volatile bool save_requested = false;
uint32_t save_request_time_ms = 0;

struct LaserParams {
  float decay_seconds;
  float amplitude_curve;
  float wave_position;
  float pitch_width_octaves;
  float start_pitch_hz;
  float end_pitch_hz;
  float pitch_tau_seconds;
};

struct LaserVoice {
  bool active;

  uint32_t sample_index;
  uint32_t duration_samples;

  float phase;
  float wobble_phase;

  float decay_seconds;
  float amplitude_curve;
  float wave_position;
  float start_pitch_hz;
  float end_pitch_hz;
  float pitch_tau_seconds;

  float log_start_pitch;
  float log_pitch_delta;
  float inv_pitch_tau;
  float inv_decay;
  float wobble_phase_inc;

  float gain;
  float volume_scale;

  bool in2_applied;
};

struct LaserStartRequest {
  LaserParams params;
  bool in2_active;
};

struct SavedLaserState {
  uint32_t magic;
  uint16_t version;
  uint16_t size;

  float decay_seconds;
  float amplitude_curve;
  float wave_position;
  float pitch_width_octaves;
  float end_pitch_hz;
  float pitch_tau_seconds;

  uint32_t checksum;
};

LaserVoice voice = {
  false,
  0,
  0,
  0.0f,
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  1.0f,
  false
};

LaserParams current_params = {
  0.100f,
  1.35f,
  5.5f,
  2.0f,
  880.0f,
  220.0f,
  0.080f
};

LaserStartRequest pending_laser = {};
volatile bool laser_pending = false;

critical_section_t laser_request_crit;

bool eeprom_ready = false;
SavedLaserState last_saved_state = {};
bool have_last_saved_state = false;

float clampf_local(float x, float lo, float hi) {
  if (x < lo) return lo;
  if (x > hi) return hi;
  return x;
}

float exp_map_norm(float norm, float low, float high) {
  return low * powf(high / low, norm);
}

float smoothstep_local(float x) {
  x = clampf_local(x, 0.0f, 1.0f);
  return x * x * (3.0f - 2.0f * x);
}

float fast_tanh_approx(float x) {
  x = clampf_local(x, -3.0f, 3.0f);
  float x2 = x * x;
  return x * (27.0f + x2) / (27.0f + 9.0f * x2);
}

uint32_t make_pwm_cc_value(uint16_t duty) {
  if (duty > PWM_WRAP) duty = PWM_WRAP;

  if (pwm_chan == PWM_CHAN_A) {
    return duty;
  } else {
    return ((uint32_t)duty << 16);
  }
}

uint32_t audio_to_pwm_cc(float x) {
  if (x > 1.0f) x = 1.0f;
  if (x < -1.0f) x = -1.0f;

  float y = x * 0.5f + 0.5f;
  uint16_t duty = (uint16_t)(y * (float)PWM_WRAP + 0.5f);

  return make_pwm_cc_value(duty);
}

uint32_t center_pwm_cc() {
  return audio_to_pwm_cc(0.0f);
}

float normalize_wave_row(int row) {
  float peak = 0.0f;

  for (int i = 0; i < WAVE_TABLE_SIZE; i++) {
    float a = fabsf(wavetable[row][i]);
    if (a > peak) peak = a;
  }

  if (peak < 0.000001f) peak = 1.0f;

  for (int i = 0; i < WAVE_TABLE_SIZE; i++) {
    wavetable[row][i] /= peak;
  }

  wavetable[row][WAVE_TABLE_SIZE] = wavetable[row][0];

  return peak;
}

void setup_wavetables() {
  for (int i = 0; i < WAVE_TABLE_SIZE; i++) {
    float p = (float)i / (float)WAVE_TABLE_SIZE;
    float s = sinf(TWO_PI_F * p);

    wavetable[0][i] = s;
    wavetable[1][i] = 4.0f * fabsf(p - 0.5f) - 1.0f;
    wavetable[2][i] = 2.0f * p - 1.0f;
    wavetable[3][i] = 1.0f - 2.0f * p;
    wavetable[4][i] = (p < 0.5f) ? 1.0f : -1.0f;
    wavetable[5][i] = (p < (1.0f / 3.0f)) ? 1.0f : -1.0f;
    wavetable[6][i] = (p < 0.25f) ? 1.0f : -1.0f;
    wavetable[7][i] = (p < 0.125f) ? 1.0f : -1.0f;
    wavetable[8][i] = tanhf(2.6f * s);
    wavetable[9][i] = 0.72f * s + 0.28f * sinf(TWO_PI_F * 2.0f * p);
    wavetable[10][i] = 0.62f * s + 0.38f * sinf(TWO_PI_F * 3.0f * p);
    wavetable[11][i] = 2.0f * fabsf(s) - 1.0f;
  }

  for (int w = 0; w < WAVE_COUNT; w++) {
    normalize_wave_row(w);
  }
}

void setup_luts() {
  setup_wavetables();

  for (int adc = 0; adc < ADC_LUT_SIZE; adc++) {
    float a = (float)adc / 4095.0f;

    decay_lut[adc] = exp_map_norm(a, DECAY_MIN_SECONDS, DECAY_MAX_SECONDS);
    amplitude_curve_lut[adc] = AMP_CURVE_MIN + (AMP_CURVE_MAX - AMP_CURVE_MIN) * a;
    wave_position_lut[adc] = a * 11.0f;
    pitch_width_lut[adc] = PITCH_WIDTH_MIN_OCT + (PITCH_WIDTH_MAX_OCT - PITCH_WIDTH_MIN_OCT) * a;
    pitch_tau_lut[adc] = exp_map_norm(a, PITCH_TAU_MIN_SECONDS, PITCH_TAU_MAX_SECONDS);
    end_pitch_lut[adc] = exp_map_norm(a, END_PITCH_MIN_HZ, END_PITCH_MAX_HZ);
  }
}

float read_single_wave(float phase, int wave_index) {
  phase = phase - floorf(phase);

  float pos = phase * (float)WAVE_TABLE_SIZE;
  int idx = (int)pos;
  float frac = pos - (float)idx;

  idx &= WAVE_TABLE_MASK;

  float a = wavetable[wave_index][idx];
  float b = wavetable[wave_index][idx + 1];
  return a + (b - a) * frac;
}

float read_morph_wave(float phase, float position) {
  position = clampf_local(position, 0.0f, 11.0f);

  int i0 = (int)floorf(position);
  if (i0 < 0) i0 = 0;
  if (i0 > 11) i0 = 11;

  int i1 = i0 + 1;
  if (i1 > 11) i1 = 11;

  float blend = smoothstep_local(position - (float)i0);

  float a = read_single_wave(phase, i0);
  float b = read_single_wave(phase, i1);
  return a + (b - a) * blend;
}

void sync_start_pitch(LaserParams &params) {
  params.start_pitch_hz = params.end_pitch_hz * powf(2.0f, params.pitch_width_octaves);
}

uint32_t fnv1a_update(uint32_t hash, const uint8_t *data, size_t len) {
  for (size_t i = 0; i < len; i++) {
    hash ^= data[i];
    hash *= 16777619UL;
  }
  return hash;
}

uint32_t calc_saved_state_checksum(const SavedLaserState &state) {
  SavedLaserState temp = state;
  temp.checksum = 0;
  return fnv1a_update(2166136261UL, (const uint8_t *)&temp, sizeof(SavedLaserState));
}

bool saved_state_is_valid(const SavedLaserState &state) {
  if (state.magic != EEPROM_MAGIC) return false;
  if (state.version != EEPROM_VERSION) return false;
  if (state.size != sizeof(SavedLaserState)) return false;
  if (state.checksum != calc_saved_state_checksum(state)) return false;

  if (state.decay_seconds < DECAY_MIN_SECONDS || state.decay_seconds > DECAY_MAX_SECONDS) return false;
  if (state.amplitude_curve < AMP_CURVE_MIN || state.amplitude_curve > AMP_CURVE_MAX) return false;
  if (state.wave_position < 0.0f || state.wave_position > 11.0f) return false;
  if (state.pitch_width_octaves < PITCH_WIDTH_MIN_OCT || state.pitch_width_octaves > PITCH_WIDTH_MAX_OCT) return false;
  if (state.end_pitch_hz < END_PITCH_MIN_HZ || state.end_pitch_hz > END_PITCH_MAX_HZ) return false;
  if (state.pitch_tau_seconds < PITCH_TAU_MIN_SECONDS || state.pitch_tau_seconds > PITCH_TAU_MAX_SECONDS) return false;

  return true;
}

SavedLaserState make_saved_state() {
  SavedLaserState state = {};

  state.magic = EEPROM_MAGIC;
  state.version = EEPROM_VERSION;
  state.size = sizeof(SavedLaserState);

  state.decay_seconds = current_params.decay_seconds;
  state.amplitude_curve = current_params.amplitude_curve;
  state.wave_position = current_params.wave_position;
  state.pitch_width_octaves = current_params.pitch_width_octaves;
  state.end_pitch_hz = current_params.end_pitch_hz;
  state.pitch_tau_seconds = current_params.pitch_tau_seconds;

  state.checksum = calc_saved_state_checksum(state);
  return state;
}

bool saved_state_equals_current_flash_copy(const SavedLaserState &state) {
  if (!have_last_saved_state) return false;
  return memcmp(&state, &last_saved_state, sizeof(SavedLaserState)) == 0;
}

void restore_params_from_saved_state(const SavedLaserState &state) {
  current_params.decay_seconds = state.decay_seconds;
  current_params.amplitude_curve = state.amplitude_curve;
  current_params.wave_position = state.wave_position;
  current_params.pitch_width_octaves = state.pitch_width_octaves;
  current_params.end_pitch_hz = state.end_pitch_hz;
  current_params.pitch_tau_seconds = state.pitch_tau_seconds;

  sync_start_pitch(current_params);
}

void restore_params_from_eeprom() {
  EEPROM.begin(EEPROM_SIZE_BYTES);
  eeprom_ready = true;

  SavedLaserState state;
  EEPROM.get(0, state);

  if (!saved_state_is_valid(state)) {
    have_last_saved_state = false;
    return;
  }

  restore_params_from_saved_state(state);

  last_saved_state = state;
  have_last_saved_state = true;
}

void save_params_to_eeprom_once_if_changed() {
  if (!eeprom_ready) return;

  sync_start_pitch(current_params);

  SavedLaserState state = make_saved_state();

  if (!saved_state_is_valid(state)) return;
  if (saved_state_equals_current_flash_copy(state)) return;

  EEPROM.put(0, state);
  EEPROM.commit();

  last_saved_state = state;
  have_last_saved_state = true;
}

void lock_adc_pickups_at_current_position() {
  for (uint8_t ch = 0; ch < 3; ch++) {
    pickup_origin[ch] = adc_avg[ch];
    picked_up[ch] = false;
  }

  pickup_rearm_pending = false;
}

void arm_pickup_for_current_page_from_fresh_adc() {
  for (uint8_t ch = 0; ch < 3; ch++) {
    pickup_origin[ch] = adc_avg[ch];
    picked_up[ch] = false;
  }

  pickup_rearm_pending = false;
}

void set_led_pwm_level(uint16_t level) {
  if (level > LED_PWM_WRAP) level = LED_PWM_WRAP;
  pwm_set_chan_level(led_pwm_slice, led_pwm_chan, level);
}

void setup_led_pwm() {
  gpio_set_function(MOD2_LED_PIN, GPIO_FUNC_PWM);

  led_pwm_slice = pwm_gpio_to_slice_num(MOD2_LED_PIN);
  led_pwm_chan = pwm_gpio_to_channel(MOD2_LED_PIN);

  pwm_config cfg = pwm_get_default_config();
  pwm_config_set_wrap(&cfg, LED_PWM_WRAP);
  pwm_config_set_clkdiv(&cfg, 125.0f);

  pwm_init(led_pwm_slice, &cfg, true);
  set_led_pwm_level(LED_LEVEL_OFF);
}

void update_in2_hold() {
  if (gpio_get(VOLUME_HALF_IN_PIN)) {
    in2_hold_until_ms = millis() + IN2_HOLD_MS;
  }
}

bool is_in2_recently_active() {
  if (gpio_get(VOLUME_HALF_IN_PIN)) return true;

  int32_t remaining = (int32_t)(in2_hold_until_ms - millis());
  return remaining > 0;
}

void apply_in2_effect_to_voice() {
  if (voice.in2_applied) return;

  voice.volume_scale = 0.5f;
  voice.in2_applied = true;
}

void pulse_led_10ms() {
  led_on_until_ms = millis() + LED_BLINK_MS;
  set_led_pwm_level(LED_LEVEL_FULL);
}

void request_laser() {
  LaserStartRequest req;

  req.params = current_params;
  req.in2_active = is_in2_recently_active();

  critical_section_enter_blocking(&laser_request_crit);
  pending_laser = req;
  laser_pending = true;
  critical_section_exit(&laser_request_crit);

  pulse_led_10ms();
}

void start_laser_from_request(const LaserStartRequest &req) {
  float decay_seconds = req.params.decay_seconds;
  float amplitude_curve = req.params.amplitude_curve;
  float wave_position = req.params.wave_position;
  float start_pitch_hz = req.params.start_pitch_hz;
  float end_pitch_hz = req.params.end_pitch_hz;
  float pitch_tau_seconds = req.params.pitch_tau_seconds;

  start_pitch_hz = clampf_local(start_pitch_hz, 24.0f, (float)SAMPLE_RATE * 0.42f);
  end_pitch_hz = clampf_local(end_pitch_hz, 24.0f, (float)SAMPLE_RATE * 0.42f);

  float tail_scale = 2.7f + 1.0f / max(0.5f, amplitude_curve);
  float duration_seconds = decay_seconds * tail_scale + 0.055f;
  duration_seconds = clampf_local(duration_seconds, 0.001f, 3.2f);

  bool in2_now = gpio_get(VOLUME_HALF_IN_PIN);
  bool in2_active = req.in2_active || in2_now;

  voice.active = true;
  voice.sample_index = 0;
  voice.duration_samples = (uint32_t)(duration_seconds * (float)SAMPLE_RATE);

  voice.phase = 0.0f;
  voice.wobble_phase = 0.0f;

  voice.decay_seconds = decay_seconds;
  voice.amplitude_curve = amplitude_curve;
  voice.wave_position = wave_position;
  voice.start_pitch_hz = start_pitch_hz;
  voice.end_pitch_hz = end_pitch_hz;
  voice.pitch_tau_seconds = pitch_tau_seconds;

  voice.log_start_pitch = logf(start_pitch_hz);
  voice.log_pitch_delta = logf(end_pitch_hz) - voice.log_start_pitch;
  voice.inv_pitch_tau = 1.0f / max(0.006f, pitch_tau_seconds);
  voice.inv_decay = 1.0f / max(0.012f, decay_seconds);

  float wobble_rate_hz = 18.0f + wave_position * 1.7f;
  voice.wobble_phase_inc = wobble_rate_hz / (float)SAMPLE_RATE;

  voice.gain = 0.88f;
  voice.volume_scale = 1.0f;
  voice.in2_applied = false;

  if (in2_active) {
    apply_in2_effect_to_voice();
  }
}

void consume_pending_laser_if_any() {
  if (!laser_pending) return;

  LaserStartRequest req;
  bool has_request = false;

  critical_section_enter_blocking(&laser_request_crit);
  if (laser_pending) {
    req = pending_laser;
    laser_pending = false;
    has_request = true;
  }
  critical_section_exit(&laser_request_crit);

  if (has_request) {
    start_laser_from_request(req);
  }
}

float render_laser_sample() {
  if (!voice.active) return 0.0f;

  if (!voice.in2_applied && voice.sample_index < IN2_GRACE_SAMPLES) {
    if (gpio_get(VOLUME_HALF_IN_PIN)) {
      apply_in2_effect_to_voice();
    }
  }

  if (voice.sample_index >= voice.duration_samples) {
    voice.active = false;
    return 0.0f;
  }

  float t = (float)voice.sample_index / (float)SAMPLE_RATE;

  float progress = 1.0f - expf(-t * voice.inv_pitch_tau);
  progress = clampf_local(progress, 0.0f, 1.0f);

  float freq = expf(voice.log_start_pitch + voice.log_pitch_delta * progress);

  float wobble_env = expf(-t / (voice.decay_seconds * 0.75f + 0.060f));
  float wobble = read_single_wave(voice.wobble_phase, 0);
  freq *= 1.0f + wobble * wobble_env * 0.012f;
  freq = clampf_local(freq, 24.0f, (float)SAMPLE_RATE * 0.42f);

  voice.phase += freq / (float)SAMPLE_RATE;
  voice.phase = voice.phase - floorf(voice.phase);

  voice.wobble_phase += voice.wobble_phase_inc;
  voice.wobble_phase = voice.wobble_phase - floorf(voice.wobble_phase);

  float main = read_morph_wave(voice.phase, voice.wave_position);
  float upper = read_morph_wave(voice.phase * 2.0f, min(11.0f, voice.wave_position + 1.35f));
  float lower = read_single_wave(voice.phase * 0.5f, 0);

  float attack = clampf_local(t / 0.0035f, 0.0f, 1.0f);
  float body_env = expf(-powf(t * voice.inv_decay, voice.amplitude_curve));
  float click_env = expf(-t / 0.0045f);
  float spark_env = expf(-t / (0.012f + voice.pitch_tau_seconds * 0.20f));

  if (body_env < 0.00020f && click_env < 0.00020f && spark_env < 0.00020f) {
    voice.active = false;
    return 0.0f;
  }

  float brightness = voice.wave_position * (1.0f / 11.0f);

  float raw = 0.0f;
  raw += main * body_env * attack * (0.76f - brightness * 0.10f);
  raw += upper * body_env * attack * (0.10f + brightness * 0.14f);
  raw += lower * body_env * attack * 0.08f;
  raw += read_single_wave(voice.phase * 3.0f, 0) * spark_env * 0.10f;
  raw += main * click_env * 0.18f;

  float drive = 1.25f + brightness * 0.55f;
  float out = fast_tanh_approx(raw * drive);

  out *= voice.gain * OUTPUT_GAIN * voice.volume_scale;

  voice.sample_index++;

  return out;
}

void fill_audio_buffer(uint8_t buf_index) {
  consume_pending_laser_if_any();

  if (!voice.active && !laser_pending) {
    uint32_t center = center_pwm_cc();

    for (uint i = 0; i < AUDIO_BLOCK_SIZE; i++) {
      wave_buffer[buf_index][i] = center;
    }

    return;
  }

  for (uint i = 0; i < AUDIO_BLOCK_SIZE; i++) {
    float sample = render_laser_sample();
    wave_buffer[buf_index][i] = audio_to_pwm_cc(sample);
  }
}

void update_trig_input() {
  bool trig_now = digitalRead(TRIG_IN_PIN);

  if (trig_last == LOW && trig_now == HIGH) {
    request_laser();
  }

  trig_last = trig_now;
}

void on_edit_page_changed(bool new_page_on) {
  edit_page_on = new_page_on;

  // Do not capture adc_avg here.
  // adc_avg may be stale because it is updated only when an ADC DMA block is processed.
  pickup_rearm_pending = true;
}

void update_push_page() {
  bool raw = digitalRead(PUSH_BUTTON_PIN);

  if (raw != button_last_raw) {
    button_last_change_ms = millis();
    button_last_raw = raw;
  }

  if ((millis() - button_last_change_ms) <= BUTTON_DEBOUNCE_MS) {
    return;
  }

  if (raw == button_stable) {
    return;
  }

  button_prev_stable = button_stable;
  button_stable = raw;

  // MOD2 PUSH uses internal pull-up.
  // HIGH -> LOW = debounced button press edge.
  if (button_prev_stable == HIGH && button_stable == LOW) {
    bool new_page_on = !edit_page_on;
    on_edit_page_changed(new_page_on);

    // Do not write Flash here.
    // EEPROM.commit() can disturb audio. Save is deferred until audio is idle.
    save_requested = true;
    save_request_time_ms = millis();
  }
}

void update_soft_takeover_params() {
  for (uint8_t ch = 0; ch < 3; ch++) {
    if (!picked_up[ch]) {
      int delta = (int)adc_avg[ch] - (int)pickup_origin[ch];

      if (abs(delta) < PICKUP_THRESHOLD) {
        continue;
      }

      picked_up[ch] = true;
    }

    uint16_t adc = adc_avg[ch];
    if (adc > 4095) adc = 4095;

    if (!edit_page_on) {
      if (ch == 0) {
        current_params.decay_seconds = decay_lut[adc];
      } else if (ch == 1) {
        current_params.amplitude_curve = amplitude_curve_lut[adc];
      } else {
        current_params.wave_position = wave_position_lut[adc];
      }
    } else {
      if (ch == 0) {
        current_params.pitch_width_octaves = pitch_width_lut[adc];
        sync_start_pitch(current_params);
      } else if (ch == 1) {
        current_params.pitch_tau_seconds = pitch_tau_lut[adc];
      } else {
        current_params.end_pitch_hz = end_pitch_lut[adc];
        sync_start_pitch(current_params);
      }
    }
  }
}

void update_led_blink() {
  int32_t remaining = (int32_t)(led_on_until_ms - millis());

  if (remaining > 0) {
    set_led_pwm_level(LED_LEVEL_FULL);
    return;
  }

  if (edit_page_on) {
    set_led_pwm_level(LED_LEVEL_DIM);
  } else {
    set_led_pwm_level(LED_LEVEL_OFF);
  }
}

void process_deferred_save() {
  if (!save_requested) return;

  if ((millis() - save_request_time_ms) < SAVE_IDLE_DELAY_MS) {
    return;
  }

  if (voice.active || laser_pending) {
    return;
  }

  if (core1_is_busy) {
    return;
  }

  save_requested = false;
  save_params_to_eeprom_once_if_changed();
}

void process_adc_buffer() {
  uint32_t sum0 = 0;
  uint32_t sum1 = 0;
  uint32_t sum2 = 0;

  for (uint i = 0; i < ADC_TOTAL_SAMPLES; i += 3) {
    sum0 += adc_buffer[i + 0];
    sum1 += adc_buffer[i + 1];
    sum2 += adc_buffer[i + 2];
  }

  adc_avg[0] = sum0 / ADC_SAMPLES_PER_CH;
  adc_avg[1] = sum1 / ADC_SAMPLES_PER_CH;

  uint16_t adc2_raw_avg = sum2 / ADC_SAMPLES_PER_CH;
  adc_avg[2] = 4095 - adc2_raw_avg;

  static bool first_adc_block = true;
  if (first_adc_block) {
    first_adc_block = false;
    lock_adc_pickups_at_current_position();
  }
}

void restart_adc_dma() {
  // Re-arm ADC DMA so every block starts from ADC0.
  // This prevents ADC1/ADC2 assignment drift after repeated PUSH operations.
  adc_run(false);

  adc_set_round_robin(0);
  adc_select_input(0);
  adc_fifo_drain();

  dma_channel_set_read_addr(adc_dma_chan, &adc_hw->fifo, false);
  dma_channel_set_write_addr(adc_dma_chan, adc_buffer, false);
  dma_channel_set_trans_count(adc_dma_chan, ADC_TOTAL_SAMPLES, false);

  adc_set_round_robin(0b00000111);

  dma_channel_start(adc_dma_chan);
  adc_run(true);
}

void __isr dma_irq_handler() {
  if (dma_channel_get_irq0_status(pwm_dma_chan)) {
    dma_channel_acknowledge_irq0(pwm_dma_chan);

    if (fill_done_id != fill_request_id) {
      audio_underrun = true;
    }

    dma_playing_buffer ^= 1;
    buffer_to_fill = dma_playing_buffer ^ 1;

    fill_request_id++;

    dma_channel_set_read_addr(
      pwm_dma_chan,
      wave_buffer[dma_playing_buffer],
      false
    );

    dma_channel_set_trans_count(
      pwm_dma_chan,
      AUDIO_BLOCK_SIZE,
      true
    );
  }

  if (dma_channel_get_irq0_status(adc_dma_chan)) {
    dma_channel_acknowledge_irq0(adc_dma_chan);

    adc_block_ready = true;
    adc_restart_requested = true;
  }
}

void setup_pwm_dma() {
  gpio_set_function(PWM_AUDIO_PIN, GPIO_FUNC_PWM);

  pwm_slice = pwm_gpio_to_slice_num(PWM_AUDIO_PIN);
  pwm_chan  = pwm_gpio_to_channel(PWM_AUDIO_PIN);

  float clk = (float)clock_get_hz(clk_sys);
  float div = clk / ((float)SAMPLE_RATE * (float)(PWM_WRAP + 1));

  pwm_config cfg = pwm_get_default_config();
  pwm_config_set_wrap(&cfg, PWM_WRAP);
  pwm_config_set_clkdiv(&cfg, div);

  pwm_init(pwm_slice, &cfg, false);
  pwm_set_chan_level(pwm_slice, pwm_chan, PWM_WRAP / 2);

  fill_audio_buffer(0);
  fill_audio_buffer(1);

  pwm_dma_chan = dma_claim_unused_channel(true);
  dma_channel_config c = dma_channel_get_default_config(pwm_dma_chan);

  channel_config_set_transfer_data_size(&c, DMA_SIZE_32);
  channel_config_set_read_increment(&c, true);
  channel_config_set_write_increment(&c, false);
  channel_config_set_dreq(&c, DREQ_PWM_WRAP0 + pwm_slice);

  dma_channel_configure(
    pwm_dma_chan,
    &c,
    &pwm_hw->slice[pwm_slice].cc,
    wave_buffer[0],
    AUDIO_BLOCK_SIZE,
    false
  );

  dma_channel_set_irq0_enabled(pwm_dma_chan, true);

  pwm_set_enabled(pwm_slice, true);
}

void setup_adc_dma() {
  adc_init();

  adc_gpio_init(ADC0_GPIO);
  adc_gpio_init(ADC1_GPIO);
  adc_gpio_init(ADC2_GPIO);

  adc_set_round_robin(0);
  adc_select_input(0);

  adc_fifo_setup(
    true,
    true,
    1,
    false,
    false
  );

  adc_fifo_drain();

  adc_set_clkdiv(4800.0f);

  adc_dma_chan = dma_claim_unused_channel(true);
  dma_channel_config c = dma_channel_get_default_config(adc_dma_chan);

  channel_config_set_transfer_data_size(&c, DMA_SIZE_16);
  channel_config_set_read_increment(&c, false);
  channel_config_set_write_increment(&c, true);
  channel_config_set_dreq(&c, DREQ_ADC);

  dma_channel_configure(
    adc_dma_chan,
    &c,
    adc_buffer,
    &adc_hw->fifo,
    ADC_TOTAL_SAMPLES,
    false
  );

  dma_channel_set_irq0_enabled(adc_dma_chan, true);
}

void core1_entry() {
  uint32_t last_handled_request = fill_request_id;

  while (true) {
    if (last_handled_request != fill_request_id) {
      core1_is_busy = true;

      uint32_t request_now = fill_request_id;
      uint8_t target = buffer_to_fill;

      fill_audio_buffer(target);

      fill_done_id = request_now;
      last_handled_request = request_now;

      core1_is_busy = false;
    }

    tight_loop_contents();
  }
}

void setup() {
  pinMode(TRIG_IN_PIN, INPUT);
  pinMode(VOLUME_HALF_IN_PIN, INPUT);
  pinMode(PUSH_BUTTON_PIN, INPUT_PULLUP);

  trig_last = digitalRead(TRIG_IN_PIN);

  button_last_raw = digitalRead(PUSH_BUTTON_PIN);
  button_stable = button_last_raw;
  button_prev_stable = button_last_raw;

  edit_page_on = false;

  setup_luts();
  sync_start_pitch(current_params);

  restore_params_from_eeprom();

  setup_led_pwm();

  critical_section_init(&laser_request_crit);

  irq_set_exclusive_handler(DMA_IRQ_0, dma_irq_handler);
  irq_set_enabled(DMA_IRQ_0, true);

  setup_pwm_dma();
  setup_adc_dma();

  multicore_launch_core1(core1_entry);

  restart_adc_dma();
  dma_channel_start(pwm_dma_chan);
}

void loop() {
  update_in2_hold();
  update_trig_input();
  update_push_page();

  if (adc_block_ready) {
    adc_block_ready = false;

    process_adc_buffer();

    if (pickup_rearm_pending) {
      arm_pickup_for_current_page_from_fresh_adc();
    } else {
      update_soft_takeover_params();
    }

    if (adc_restart_requested) {
      adc_restart_requested = false;
      restart_adc_dma();
    }
  }

  update_led_blink();
  process_deferred_save();
}
